/**
 * @file xplt.peripheral.c
 * @brief Portable C2000 LaunchPad binding for UART, ADC ISR and user LED.
 */

#include <gmp_core.h>

#include "user_dl.h"
#include <xplt.peripheral.h>
#include <launchpad_board.h>

#ifndef XPLT_DL_BAUD_RATE
#define XPLT_DL_BAUD_RATE 115200UL
#endif

#define XPLT_DL_RX_FIFO_LEVEL SCI_FIFO_RX8
#define XPLT_DL_LOCAL_RX_SIZE 16U

#if XPLT_DL_BAUD_RATE > 500000UL
#define XPLT_DL_LSPCLK_HZ (DEVICE_SYSCLK_FREQ / 2UL)
#else
#define XPLT_DL_LSPCLK_HZ DEVICE_LSPCLK_FREQ
#endif

static gmp_datalink_t* bound_datalink;
volatile uint32_t control_isr_runs;
static uint16_t dsa_sample_divider;
#if LAUNCHPAD_CAN_CLASSIC
volatile uint16_t can_last_rx[8];
volatile uint32_t can_rx_count;
volatile uint16_t can_bus_active;
#endif

/** @brief SysConfig-owned SCIA receive FIFO interrupt handler. */
__interrupt void INT_LAUNCHXL_UART_USB_RX_ISR(void);

/** @brief ADC control interrupt generated by SysConfig. */
__interrupt void MainISR(void);

/** SysConfig baseline represented by every board-local ePWM period. */
#define XPLT_PWM_REFERENCE_FREQUENCY_HZ 20000UL

#if GMP_LAUNCHPAD_PWM_FREQUENCY_HZ < 1000UL
#error "GMP_LAUNCHPAD_PWM_FREQUENCY_HZ must be at least 1000 Hz"
#endif

/** All physical BOOSTXL PWM pairs use the same instance names on every board. */
static const uint32_t boostxl_pwm_bases[] = {
    BOOSTXL_EPWM4039_BASE,
    BOOSTXL_EPWM3837_BASE,
    BOOSTXL_EPWM3635_BASE,
    BOOSTXL_EPWM8079_BASE,
    BOOSTXL_EPWM7877_BASE,
    BOOSTXL_EPWM7675_BASE
};

/** Apply the SDPE frequency and start all six center-aligned counters together. */
static void xplt_configure_control_pwms(void)
{
    uint32_t reference_period = EPWM_getTimeBasePeriod(LAUNCHPAD_CONTROL_PWM_BASE);
    uint32_t scaled_period;
    uint16_t period;
    uint16_t index;

    scaled_period = (reference_period * XPLT_PWM_REFERENCE_FREQUENCY_HZ) /
                    (uint32_t)GMP_LAUNCHPAD_PWM_FREQUENCY_HZ;
    if (scaled_period < 2UL)
        scaled_period = 2UL;
    else if (scaled_period > 65535UL)
        scaled_period = 65535UL;
    period = (uint16_t)scaled_period;

    SysCtl_disablePeripheral(SYSCTL_PERIPH_CLK_TBCLKSYNC);
    for (index = 0U;
         index < (uint16_t)(sizeof(boostxl_pwm_bases) / sizeof(boostxl_pwm_bases[0]));
         ++index)
    {
        uint32_t base = boostxl_pwm_bases[index];
        EPWM_setTimeBaseCounterMode(base, EPWM_COUNTER_MODE_STOP_FREEZE);
        EPWM_setTimeBasePeriod(base, period);
        EPWM_setPhaseShift(base, 0U);
        EPWM_setTimeBaseCounter(base, 0U);
        EPWM_setCounterCompareValue(base, EPWM_COUNTER_COMPARE_A, period / 2U);
        EPWM_setCounterCompareValue(base, EPWM_COUNTER_COMPARE_B, period / 4U);
        EPWM_setTimeBaseCounterMode(base, EPWM_COUNTER_MODE_UP_DOWN);
    }
    SysCtl_enablePeripheral(SYSCTL_PERIPH_CLK_TBCLKSYNC);
}

/**
 * @brief Drain all currently buffered SCIA characters into the Data Link FIFO.
 * @details Each C28x character occupies one native 16-bit data unit while only
 * the low eight bits are part of the wire protocol.
 */
static void xplt_dl_drain_rx_fifo(void)
{
    byte_gt local_buffer[XPLT_DL_LOCAL_RX_SIZE];
    size_gt count;
    size_gt index;

    if (bound_datalink == NULL)
    {
        while (SCI_getRxFIFOStatus(LAUNCHXL_UART_USB_BASE) != SCI_FIFO_RX0)
            (void)SCI_readCharNonBlocking(LAUNCHXL_UART_USB_BASE);
        return;
    }

    /* RXFFST is sampled exactly once.  Chasing a continuously changing FIFO
     * level can over-read RXBUF while the next UART character is still being
     * shifted in; that presents stale data as a payload byte on C28x SCI. */
    count = (size_gt)SCI_getRxFIFOStatus(LAUNCHXL_UART_USB_BASE);
    if (count > XPLT_DL_LOCAL_RX_SIZE)
        count = XPLT_DL_LOCAL_RX_SIZE;
    for (index = 0U; index < count; ++index)
        local_buffer[index] = (byte_gt)(SCI_readCharNonBlocking(LAUNCHXL_UART_USB_BASE) & 0x00FFU);
    if (count > 0U)
        gmp_dev_dl_push_str(bound_datalink, local_buffer, count);
}

/** @brief Configure SCIA for the LaunchPad XDS110 Application/User UART. */
static void xplt_configure_scia(void)
{
#if XPLT_DL_BAUD_RATE > 500000UL
    /* A 50 MHz LSPCLK minimizes the F280049C divider error at 921600 baud. */
    SysCtl_setLowSpeedClock(SYSCTL_LSPCLK_PRESCALE_2);
#endif

    SCI_performSoftwareReset(LAUNCHXL_UART_USB_BASE);
    SCI_setConfig(LAUNCHXL_UART_USB_BASE, XPLT_DL_LSPCLK_HZ, XPLT_DL_BAUD_RATE,
                  SCI_CONFIG_WLEN_8 | SCI_CONFIG_STOP_ONE | SCI_CONFIG_PAR_NONE);
#if XPLT_DL_BAUD_RATE == 921600UL
    /* Force BRR=6: 50 MHz / (8 * (6 + 1)) = 892857 baud. */
    HWREGH(LAUNCHXL_UART_USB_BASE + SCI_O_HBAUD) = 0U;
    HWREGH(LAUNCHXL_UART_USB_BASE + SCI_O_LBAUD) = 6U;
#endif
    SCI_resetChannels(LAUNCHXL_UART_USB_BASE);
    SCI_enableFIFO(LAUNCHXL_UART_USB_BASE);
    SCI_setFIFOInterruptLevel(LAUNCHXL_UART_USB_BASE, SCI_FIFO_TX0, XPLT_DL_RX_FIFO_LEVEL);
    SCI_clearInterruptStatus(LAUNCHXL_UART_USB_BASE, SCI_INT_RXFF | SCI_INT_TXFF | SCI_INT_RXERR);
    SCI_enableInterrupt(LAUNCHXL_UART_USB_BASE, SCI_INT_RXFF | SCI_INT_RXERR);
    SCI_enableModule(LAUNCHXL_UART_USB_BASE);
    SCI_performSoftwareReset(LAUNCHXL_UART_USB_BASE);
}

void setup_peripheral(void)
{
    debug_uart = NULL;
    bound_datalink = NULL;

    xplt_configure_control_pwms();

#ifdef ENABLE_PORT
    GPIO_writePin(ENABLE_PORT, 0U);
#endif
#ifdef RELAY_PORT
    GPIO_writePin(RELAY_PORT, 0U);
#endif

    GPIO_writePin(LAUNCHPAD_USER_LED_GPIO, 1U);

    xplt_configure_scia();
#if LAUNCHPAD_CAN_CLASSIC
    /* A disconnected evaluation board must not retry forever and starve the
     * control/Data Link interrupts while waiting for a CAN acknowledgement. */
    CAN_disableRetry(LAUNCHPAD_CAN_BASE);
    can_bus_active = 0U;
    /* Poll the receive object from the 2 ms service. A disconnected CAN bus
     * can otherwise generate a status-interrupt storm that starves SCIA. */
    CAN_disableInterrupt(LAUNCHPAD_CAN_BASE, CAN_INT_IE0);
    CAN_disableGlobalInterrupt(LAUNCHPAD_CAN_BASE, CAN_GLOBAL_INT_CANINT0);
    Interrupt_disable(INT_LAUNCHXL_CAN_0);
    Interrupt_disable(INT_LAUNCHXL_CAN_1);
#endif
    Interrupt_clearACKGroup(INT_LAUNCHXL_UART_USB_RX_INTERRUPT_ACK_GROUP);
}

void xplt_dl_bind(gmp_datalink_t* datalink)
{
    bound_datalink = datalink;
}

void xplt_dl_poll_rx(void)
{
    Interrupt_disable(INT_LAUNCHXL_UART_USB_RX);
    xplt_dl_drain_rx_fifo();
    SCI_clearInterruptStatus(LAUNCHXL_UART_USB_BASE, SCI_INT_RXFF);
    Interrupt_enable(INT_LAUNCHXL_UART_USB_RX);
}

void xplt_dl_start_tx(gmp_datalink_t* datalink)
{
    SCI_writeCharArray(LAUNCHXL_UART_USB_BASE,
                       (const uint16_t*)gmp_dev_dl_get_tx_hw_hdr_ptr(datalink),
                       (uint16_t)gmp_dev_dl_get_tx_hw_hdr_size(datalink));
    if (gmp_dev_dl_get_tx_hw_pld_size(datalink) > 0U)
    {
        SCI_writeCharArray(LAUNCHXL_UART_USB_BASE,
                           (const uint16_t*)gmp_dev_dl_get_tx_hw_pld_ptr(datalink),
                           (uint16_t)gmp_dev_dl_get_tx_hw_pld_size(datalink));
    }
    while (SCI_isTransmitterBusy(LAUNCHXL_UART_USB_BASE))
    {
    }
    gmp_dev_dl_tx_state_done(datalink);
}

void xplt_start_sample_timer(void)
{
    Interrupt_enable(INT_BOOSTXL_ADCA_1);
}

void xplt_toggle_user_led(void)
{
    GPIO_togglePin(LAUNCHPAD_USER_LED_GPIO);
}

void xplt_set_gate_enable(uint16_t enable)
{
#ifdef ENABLE_PORT
    GPIO_writePin(ENABLE_PORT, enable ? 1U : 0U);
#else
    (void)enable;
#endif
}

void xplt_set_relay(uint16_t closed)
{
#ifdef RELAY_PORT
    GPIO_writePin(RELAY_PORT, closed ? 1U : 0U);
#else
    (void)closed;
#endif
}

uint16_t xplt_get_over_temperature(void)
{
#ifdef OVER_TEMPERATURE
    return GPIO_readPin(OVER_TEMPERATURE);
#else
    return 0U;
#endif
}

void xplt_can_service(void)
{
#if LAUNCHPAD_CAN_CLASSIC
    static time_gt last_tx_tick;
    time_gt now = gmp_base_get_system_tick();

    if ((CAN_getNewDataFlags(LAUNCHPAD_CAN_BASE) & 0x00000001UL) != 0UL)
    {
        CAN_readMessage(LAUNCHPAD_CAN_BASE, 1U, (uint16_t*)can_last_rx);
        can_rx_count++;
        can_bus_active = 1U;
    }

    if (can_bus_active &&
        (time_gt)(now - last_tx_tick) >= GMP_CAN_TX_PERIOD_MS)
    {
        uint16_t payload[4];
        uint16_t pwm_value = (uint16_t)((float)launchpad_output_pu * 4095.0F);
        payload[0] = launchpad_adc_raw & 0x00FFU;
        payload[1] = (launchpad_adc_raw >> 8U) & 0x00FFU;
        payload[2] = pwm_value & 0x00FFU;
        payload[3] = (pwm_value >> 8U) & 0x00FFU;
        CAN_sendMessage(LAUNCHPAD_CAN_BASE, 4U, 4U, payload);
        last_tx_tick = now;
    }
#elif LAUNCHPAD_CAN_MCAN
    /* MCAN targets bind the same service contract in their board-specific port. */
#endif
}

/** @brief Drain one stable FIFO snapshot whenever eight characters are ready. */
__interrupt void INT_LAUNCHXL_UART_USB_RX_ISR(void)
{
    xplt_dl_drain_rx_fifo();
    if ((SCI_getRxStatus(LAUNCHXL_UART_USB_BASE) & SCI_RXSTATUS_OVERRUN) != 0U)
    {
        SCI_clearOverflowStatus(LAUNCHXL_UART_USB_BASE);
        SCI_resetRxFIFO(LAUNCHXL_UART_USB_BASE);
    }
    SCI_clearInterruptStatus(LAUNCHXL_UART_USB_BASE, SCI_INT_RXFF | SCI_INT_RXERR);
    Interrupt_clearACKGroup(INT_LAUNCHXL_UART_USB_RX_INTERRUPT_ACK_GROUP);
}

#if LAUNCHPAD_CAN_CLASSIC
/** @brief Receive command frame 0x101 and acknowledge classic CAN interrupts. */
__interrupt void INT_LAUNCHXL_CAN_0_ISR(void)
{
    uint32_t cause = CAN_getInterruptCause(LAUNCHPAD_CAN_BASE);
    if (cause == 1U)
    {
        CAN_readMessage(LAUNCHPAD_CAN_BASE, 1U, (uint16_t*)can_last_rx);
        CAN_clearInterruptStatus(LAUNCHPAD_CAN_BASE, 1U);
        can_rx_count++;
        can_bus_active = 1U;
    }
    else if (cause == CAN_INT_INT0ID_STATUS)
    {
        /* Reading ES clears the status interrupt source. */
        (void)CAN_getStatus(LAUNCHPAD_CAN_BASE);
    }
    else if (cause != 0U)
    {
        CAN_clearInterruptStatus(LAUNCHPAD_CAN_BASE, cause);
    }
    CAN_clearGlobalInterruptStatus(LAUNCHPAD_CAN_BASE,
                                   CAN_GLOBAL_INT_CANINT0);
    Interrupt_clearACKGroup(INT_LAUNCHXL_CAN_0_INTERRUPT_ACK_GROUP);
}

__interrupt void INT_LAUNCHXL_CAN_1_ISR(void)
{
    CAN_clearGlobalInterruptStatus(LAUNCHPAD_CAN_BASE,
                                   CAN_GLOBAL_INT_CANINT1);
    Interrupt_clearACKGroup(INT_LAUNCHXL_CAN_1_INTERRUPT_ACK_GROUP);
}
#endif

/** @brief Run the portable control path from the ePWM-triggered ADC interrupt. */
__interrupt void MainISR(void)
{
    control_isr_runs++;
    gmp_base_ctl_step();
    dsa_sample_divider++;
    if (dsa_sample_divider >= (GMP_LAUNCHPAD_PWM_FREQUENCY_HZ / 1000UL))
    {
        dsa_sample_divider = 0U;
        user_dl_dsa_timer_step();
    }
    gmp_step_system_tick();
    ADC_clearInterruptStatus(BOOSTXL_ADCA_BASE, ADC_INT_NUMBER1);
    if (ADC_getInterruptOverflowStatus(BOOSTXL_ADCA_BASE, ADC_INT_NUMBER1))
    {
        ADC_clearInterruptOverflowStatus(BOOSTXL_ADCA_BASE, ADC_INT_NUMBER1);
        ADC_clearInterruptStatus(BOOSTXL_ADCA_BASE, ADC_INT_NUMBER1);
    }
    Interrupt_clearACKGroup(INT_BOOSTXL_ADCA_1_INTERRUPT_ACK_GROUP);
}
