/**
 * @cliArgs --board "/boards/LAUNCHXL_F28P65X" --context "CPU1" --product "C2000WARE@5.04.00.00"
 * @versions {"tool":"1.21.0+3721"}
 * GMP control-first reference for CPU1 of LAUNCHXL-F28P65X.
 */
const adc = scripting.addModule("/driverlib/adc.js", {}, false);
const adc1 = adc.addInstance();
const adc2 = adc.addInstance();
const adc3 = adc.addInstance();
const analog = scripting.addModule("/driverlib/analog.js", {}, false);
const analog1 = analog.addInstance();
const can = scripting.addModule("/driverlib/can.js", {}, false);
const can1 = can.addInstance();
const dac = scripting.addModule("/driverlib/dac.js", {}, false);
const dac1 = dac.addInstance();
const dac2 = dac.addInstance();
const device_support = scripting.addModule("/driverlib/device_support.js");
device_support.useStandardCodeStartBranch = false;
const epwm = scripting.addModule("/driverlib/epwm.js", {}, false);
const epwm1 = epwm.addInstance();
const epwm2 = epwm.addInstance();
const epwm3 = epwm.addInstance();
const epwm4 = epwm.addInstance();
const epwm5 = epwm.addInstance();
const epwm6 = epwm.addInstance();
const gpio = scripting.addModule("/driverlib/gpio.js", {}, false);
const gpio1 = gpio.addInstance();
const gpio2 = gpio.addInstance();
const gpio3 = gpio.addInstance();
const gpio4 = gpio.addInstance();
const sci = scripting.addModule("/driverlib/sci.js", {}, false);
const sci1 = sci.addInstance();

adc1.$name = "BOOSTXL_ADCA";
adc1.adcClockPrescaler = "ADC_CLK_DIV_4_0";
adc1.interruptPulseMode = "ADC_PULSE_END_OF_CONV";
adc1.enabledSOCs = ["ADC_SOC_NUMBER0","ADC_SOC_NUMBER1","ADC_SOC_NUMBER2","ADC_SOC_NUMBER3","ADC_SOC_NUMBER4","ADC_SOC_NUMBER5"];
adc1.enabledInts = ["ADC_INT_NUMBER1"];
adc1.enableInterrupt1 = true;
adc1.enableInterrupt1ContinuousMode = true;
adc1.interrupt1SOCSource = "ADC_INT_TRIGGER_EOC5";
adc1.registerInterrupts = ["1"];
adc1.adcInt1.enableInterrupt = true;
adc1.adcInt1.interruptHandler = "MainISR";
adc1.soc0Name = "BOOSTXL_ADC23"; adc1.soc0IndependentNameMode = true; adc1.soc0Channel = "ADC_CH_ADCIN14"; adc1.soc0SampleWindow = 15; adc1.soc0Trigger = "ADC_TRIGGER_EPWM1_SOCA";
adc1.soc1Name = "BOOSTXL_ADC24"; adc1.soc1IndependentNameMode = true; adc1.soc1Channel = "ADC_CH_ADCIN4";  adc1.soc1SampleWindow = 15; adc1.soc1Trigger = "ADC_TRIGGER_EPWM1_SOCA";
adc1.soc2Name = "BOOSTXL_ADC27"; adc1.soc2IndependentNameMode = true; adc1.soc2Channel = "ADC_CH_ADCIN7";  adc1.soc2SampleWindow = 15; adc1.soc2Trigger = "ADC_TRIGGER_EPWM1_SOCA";
adc1.soc3Name = "BOOSTXL_ADC42"; adc1.soc3IndependentNameMode = true; adc1.soc3Channel = "ADC_CH_ADCIN5";  adc1.soc3SampleWindow = 15; adc1.soc3Trigger = "ADC_TRIGGER_EPWM1_SOCA";
adc1.soc4Name = "BOOSTXL_ADC64"; adc1.soc4IndependentNameMode = true; adc1.soc4Channel = "ADC_CH_ADCIN8";  adc1.soc4SampleWindow = 15; adc1.soc4Trigger = "ADC_TRIGGER_EPWM1_SOCA";
adc1.soc5Name = "BOOSTXL_ADC67"; adc1.soc5IndependentNameMode = true; adc1.soc5Channel = "ADC_CH_ADCIN10"; adc1.soc5SampleWindow = 15; adc1.soc5Trigger = "ADC_TRIGGER_EPWM1_SOCA";

adc2.$name = "BOOSTXL_ADCB"; adc2.adcBase = "ADCB_BASE"; adc2.adcClockPrescaler = "ADC_CLK_DIV_4_0"; adc2.interruptPulseMode = "ADC_PULSE_END_OF_CONV";
adc2.enabledSOCs = ["ADC_SOC_NUMBER0","ADC_SOC_NUMBER1","ADC_SOC_NUMBER2","ADC_SOC_NUMBER3","ADC_SOC_NUMBER4","ADC_SOC_NUMBER5"];
adc2.soc0Name = "BOOSTXL_ADC2";  adc2.soc0IndependentNameMode = true; adc2.soc0Channel = "ADC_CH_ADCIN0";  adc2.soc0SampleWindow = 15; adc2.soc0Trigger = "ADC_TRIGGER_EPWM1_SOCA";
adc2.soc1Name = "BOOSTXL_ADC25"; adc2.soc1IndependentNameMode = true; adc2.soc1Channel = "ADC_CH_ADCIN4";  adc2.soc1SampleWindow = 15; adc2.soc1Trigger = "ADC_TRIGGER_EPWM1_SOCA";
adc2.soc2Name = "BOOSTXL_ADC28"; adc2.soc2IndependentNameMode = true; adc2.soc2Channel = "ADC_CH_ADCIN7";  adc2.soc2SampleWindow = 15; adc2.soc2Trigger = "ADC_TRIGGER_EPWM1_SOCA";
adc2.soc3Name = "BOOSTXL_ADC63"; adc2.soc3IndependentNameMode = true; adc2.soc3Channel = "ADC_CH_ADCIN15"; adc2.soc3SampleWindow = 15; adc2.soc3Trigger = "ADC_TRIGGER_EPWM1_SOCA";
adc2.soc4Name = "BOOSTXL_ADC65"; adc2.soc4IndependentNameMode = true; adc2.soc4Channel = "ADC_CH_ADCIN3";  adc2.soc4SampleWindow = 15; adc2.soc4Trigger = "ADC_TRIGGER_EPWM1_SOCA";
adc2.soc5Name = "BOOSTXL_ADC68"; adc2.soc5IndependentNameMode = true; adc2.soc5Channel = "ADC_CH_ADCIN6";  adc2.soc5SampleWindow = 15; adc2.soc5Trigger = "ADC_TRIGGER_EPWM1_SOCA";

adc3.$name = "BOOSTXL_ADCC"; adc3.adcBase = "ADCC_BASE"; adc3.adcClockPrescaler = "ADC_CLK_DIV_4_0"; adc3.interruptPulseMode = "ADC_PULSE_END_OF_CONV";
adc3.enabledSOCs = ["ADC_SOC_NUMBER0","ADC_SOC_NUMBER1","ADC_SOC_NUMBER2","ADC_SOC_NUMBER3","ADC_SOC_NUMBER4","ADC_SOC_NUMBER5"];
adc3.soc0Name = "BOOSTXL_ADC6";  adc3.soc0IndependentNameMode = true; adc3.soc0Channel = "ADC_CH_ADCIN0"; adc3.soc0SampleWindow = 15; adc3.soc0Trigger = "ADC_TRIGGER_EPWM1_SOCA";
adc3.soc1Name = "BOOSTXL_ADC26"; adc3.soc1IndependentNameMode = true; adc3.soc1Channel = "ADC_CH_ADCIN4"; adc3.soc1SampleWindow = 15; adc3.soc1Trigger = "ADC_TRIGGER_EPWM1_SOCA";
adc3.soc2Name = "BOOSTXL_ADC29"; adc3.soc2IndependentNameMode = true; adc3.soc2Channel = "ADC_CH_ADCIN7"; adc3.soc2SampleWindow = 15; adc3.soc2Trigger = "ADC_TRIGGER_EPWM1_SOCA";
adc3.soc3Name = "BOOSTXL_ADC46"; adc3.soc3IndependentNameMode = true; adc3.soc3Channel = "ADC_CH_ADCIN1"; adc3.soc3SampleWindow = 15; adc3.soc3Trigger = "ADC_TRIGGER_EPWM1_SOCA";
adc3.soc4Name = "BOOSTXL_ADC66"; adc3.soc4IndependentNameMode = true; adc3.soc4Channel = "ADC_CH_ADCIN5"; adc3.soc4SampleWindow = 15; adc3.soc4Trigger = "ADC_TRIGGER_EPWM1_SOCA";
adc3.soc5Name = "BOOSTXL_ADC69"; adc3.soc5IndependentNameMode = true; adc3.soc5Channel = "ADC_CH_ADCIN6"; adc3.soc5SampleWindow = 15; adc3.soc5Trigger = "ADC_TRIGGER_EPWM1_SOCA";

dac1.$name = "BOOSTXL_DACA";
dac1.enableOutput = true;
dac2.$name = "BOOSTXL_DACC"; dac2.dacBase = "DACC_BASE"; dac2.enableOutput = true;
analog1.$name = "BOOSTXL_ANALOG";
analog1.useCase = "CUSTOM";
analog1.useInterfacePins = ["A0/DACA_OUT","A10, GPIO213","A14/B14/C14","A15/B15/C15","A4","A5","A7, GPIO210","A8, GPIO211","B0/VDAC","B1/DACC_OUT","B3","B4, GPIO215","B6, GPIO207","B7, GPIO208","C0, GPIO199","C1, GPIO200","C4, GPIO205","C5, GPIO204","C6, GPIO203","C7, GPIO198"];
adc1.analog = analog1;
adc2.analog = analog1;
adc3.analog = analog1;
dac1.analog = analog1;
dac2.analog = analog1;

function configurePwm(instance, name, peripheral, pinA, pinB) {
    instance.$name = name;
    instance.epwmTimebase_hsClockDiv = "EPWM_HSCLOCK_DIVIDER_1";
    instance.epwmTimebase_counterMode = "EPWM_COUNTER_MODE_UP_DOWN";
    instance.epwmTimebase_counterModeAfterSync = "EPWM_COUNT_MODE_UP_AFTER_SYNC";
    instance.epwmTimebase_phaseEnable = true;
    instance.epwmTimebase_period = 5000;
    instance.epwmCounterCompare_cmpA = 2500;
    instance.epwmCounterCompare_cmpB = 1250;
    instance.epwmActionQualifier_EPWM_AQ_OUTPUT_A_ON_TIMEBASE_UP_CMPA = "EPWM_AQ_OUTPUT_HIGH";
    instance.epwmActionQualifier_EPWM_AQ_OUTPUT_A_ON_TIMEBASE_DOWN_CMPA = "EPWM_AQ_OUTPUT_LOW";
    instance.epwm.$assign = peripheral;
    instance.epwm.epwm_aPin.$assign = pinA;
    instance.epwm.epwm_bPin.$assign = pinB;
}
configurePwm(epwm1, "BOOSTXL_EPWM4039", "EPWM5", "GPIO8", "GPIO9");
configurePwm(epwm2, "BOOSTXL_EPWM3837", "EPWM4", "GPIO6", "GPIO7");
configurePwm(epwm3, "BOOSTXL_EPWM3635", "EPWM6", "GPIO10", "GPIO11");
configurePwm(epwm4, "BOOSTXL_EPWM8079", "EPWM2", "GPIO2", "GPIO3");
configurePwm(epwm5, "BOOSTXL_EPWM7877", "EPWM1", "GPIO0", "GPIO1");
epwm5.epwmEventTrigger_EPWM_SOC_A_triggerEnable = true;
epwm5.epwmEventTrigger_EPWM_SOC_A_triggerSource = "EPWM_SOC_TBCTR_PERIOD";
epwm5.epwmEventTrigger_EPWM_SOC_A_triggerEventPrescalar = "1";
configurePwm(epwm6, "BOOSTXL_EPWM7675", "EPWM8", "GPIO99", "GPIO75");

gpio1.$name = "LED_G";
gpio1.direction = "GPIO_DIR_MODE_OUT";
gpio1.gpioPin.$assign = "GPIO13";
gpio2.$name = "ENABLE_PORT"; gpio2.direction = "GPIO_DIR_MODE_OUT"; gpio2.initialValue = 0; gpio2.gpioPin.$assign = "GPIO12";
gpio3.$name = "RELAY_PORT"; gpio3.direction = "GPIO_DIR_MODE_OUT"; gpio3.initialValue = 0; gpio3.gpioPin.$assign = "GPIO15";
gpio4.$name = "OVER_TEMPERATURE"; gpio4.direction = "GPIO_DIR_MODE_IN"; gpio4.gpioPin.$assign = "GPIO14";

sci1.$name = "LAUNCHXL_UART_USB";
sci1.selectRegisteredInterrupts = ["registerRxInt"];
sci1.enabledFIFOInterrupts = ["SCI_INT_RXFF"];
sci1.enabledErrorInterrupts = ["SCI_INT_FE","SCI_INT_OE"];
sci1.rxFifo = "SCI_FIFO_RX8";
sci1.baudRates = 115200;
sci1.sci.$assign = "SCIA";
sci1.sci.sci_rxPin.$assign = "GPIO43";
sci1.sci.sci_txPin.$assign = "GPIO42";
sci1.sciRXInt.enableInterrupt = true;

can1.$name = "LAUNCHXL_CAN";
can1.bitRate = "1000000";
can1.enableInterrupt = true;
can1.registerInterrupts = true;
can1.interruptFlags = ["CAN_INT_IE0"];
can1.interruptLine = ["CAN_GLOBAL_INT_CANINT0"];
can1.msgObjsUsed = [1,2,3,4];
can1.can.$assign = "CANA";
can1.can.can_rxPin.$assign = "GPIO5";
can1.can.can_txPin.$assign = "GPIO4";
can1.msgObj1.$name = "msgObj0"; can1.msgObj1.msgID = 257;
can1.msgObj2.$name = "msgObj1"; can1.msgObj2.msgID = 258;
can1.msgObj3.$name = "msgObj2"; can1.msgObj3.msgID = 259;
can1.msgObj4.$name = "msgObj3"; can1.msgObj4.msgID = 513; can1.msgObj4.msgType = "CAN_MSG_OBJ_TYPE_TX";
