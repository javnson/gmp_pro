/**
 * @cliArgs --board "/boards/LAUNCHXL_F28P55X" --context "system" --product "C2000WARE@5.04.00.00"
 * @versions {"tool":"1.21.0+3721"}
 * GMP control-first reference for LAUNCHXL-F28P55X.
 */
const adc = scripting.addModule("/driverlib/adc.js", {}, false);
const adc1 = adc.addInstance();
const adc2 = adc.addInstance();
const adc3 = adc.addInstance();
const adc4 = adc.addInstance();
const adc5 = adc.addInstance();
const analog = scripting.addModule("/driverlib/analog.js", {}, false);
const analog1 = analog.addInstance();
const dac = scripting.addModule("/driverlib/dac.js", {}, false);
const dac1 = dac.addInstance();
const device_support = scripting.addModule("/driverlib/device_support.js");
device_support.useStandardCodeStartBranch = false;
const epwm = scripting.addModule("/driverlib/epwm.js", {}, false);
const epwm1 = epwm.addInstance();
const epwm2 = epwm.addInstance();
const epwm3 = epwm.addInstance();
const epwm4 = epwm.addInstance();
const epwm5 = epwm.addInstance();
const epwm6 = epwm.addInstance();
const gpio = scripting.addModule("/driverlib/gpio.js", {}, false);
const gpio1 = gpio.addInstance();
const gpio2 = gpio.addInstance();
const gpio3 = gpio.addInstance();
const gpio4 = gpio.addInstance();
const mcan = scripting.addModule("/driverlib/mcan.js", {}, false);
const mcan1 = mcan.addInstance();
const sci = scripting.addModule("/driverlib/sci.js", {}, false);
const sci1 = sci.addInstance();

adc1.$name = "BOOSTXL_ADCA";
adc1.adcClockPrescaler = "ADC_CLK_DIV_4_0";
adc1.interruptPulseMode = "ADC_PULSE_END_OF_CONV";
adc1.enabledSOCs = ["ADC_SOC_NUMBER0","ADC_SOC_NUMBER1","ADC_SOC_NUMBER2","ADC_SOC_NUMBER3"];
adc1.enabledInts = ["ADC_INT_NUMBER1"];
adc1.enableInterrupt1 = true;
adc1.enableInterrupt1ContinuousMode = true;
adc1.interrupt1SOCSource = "ADC_INT_TRIGGER_EOC3";
adc1.registerInterrupts = ["1"];
adc1.adcInt1.enableInterrupt = true;
adc1.adcInt1.interruptHandler = "MainISR";
adc1.soc0Name = "BOOSTXL_ADC25"; adc1.soc0IndependentNameMode = true; adc1.soc0Channel = "ADC_CH_ADCIN11"; adc1.soc0SampleWindow = 15; adc1.soc0Trigger = "ADC_TRIGGER_EPWM1_SOCA";
adc1.soc1Name = "BOOSTXL_ADC26"; adc1.soc1IndependentNameMode = true; adc1.soc1Channel = "ADC_CH_ADCIN14"; adc1.soc1SampleWindow = 15; adc1.soc1Trigger = "ADC_TRIGGER_EPWM1_SOCA";
adc1.soc2Name = "BOOSTXL_ADC46"; adc1.soc2IndependentNameMode = true; adc1.soc2Channel = "ADC_CH_ADCIN9";  adc1.soc2SampleWindow = 15; adc1.soc2Trigger = "ADC_TRIGGER_EPWM1_SOCA";
adc1.soc3Name = "BOOSTXL_ADC65"; adc1.soc3IndependentNameMode = true; adc1.soc3Channel = "ADC_CH_ADCIN5";  adc1.soc3SampleWindow = 15; adc1.soc3Trigger = "ADC_TRIGGER_EPWM1_SOCA";

adc2.$name = "BOOSTXL_ADCB"; adc2.adcBase = "ADCB_BASE"; adc2.adcClockPrescaler = "ADC_CLK_DIV_4_0"; adc2.interruptPulseMode = "ADC_PULSE_END_OF_CONV";
adc2.enabledSOCs = ["ADC_SOC_NUMBER0","ADC_SOC_NUMBER1","ADC_SOC_NUMBER2","ADC_SOC_NUMBER3"];
adc2.soc0Name = "BOOSTXL_ADC28"; adc2.soc0IndependentNameMode = true; adc2.soc0Channel = "ADC_CH_ADCIN3"; adc2.soc0SampleWindow = 15; adc2.soc0Trigger = "ADC_TRIGGER_EPWM1_SOCA";
adc2.soc1Name = "BOOSTXL_ADC63"; adc2.soc1IndependentNameMode = true; adc2.soc1Channel = "ADC_CH_ADCIN0"; adc2.soc1SampleWindow = 15; adc2.soc1Trigger = "ADC_TRIGGER_EPWM1_SOCA";
adc2.soc2Name = "BOOSTXL_ADC66"; adc2.soc2IndependentNameMode = true; adc2.soc2Channel = "ADC_CH_ADCIN8"; adc2.soc2SampleWindow = 15; adc2.soc2Trigger = "ADC_TRIGGER_EPWM1_SOCA";
adc2.soc3Name = "BOOSTXL_ADC67"; adc2.soc3IndependentNameMode = true; adc2.soc3Channel = "ADC_CH_ADCIN4"; adc2.soc3SampleWindow = 15; adc2.soc3Trigger = "ADC_TRIGGER_EPWM1_SOCA";

adc3.$name = "BOOSTXL_ADCC"; adc3.adcBase = "ADCC_BASE"; adc3.adcClockPrescaler = "ADC_CLK_DIV_4_0"; adc3.interruptPulseMode = "ADC_PULSE_END_OF_CONV";
adc3.enabledSOCs = ["ADC_SOC_NUMBER0","ADC_SOC_NUMBER1","ADC_SOC_NUMBER2","ADC_SOC_NUMBER3"];
adc3.soc0Name = "BOOSTXL_ADC27"; adc3.soc0IndependentNameMode = true; adc3.soc0Channel = "ADC_CH_ADCIN9";  adc3.soc0SampleWindow = 15; adc3.soc0Trigger = "ADC_TRIGGER_EPWM1_SOCA";
adc3.soc1Name = "BOOSTXL_ADC42"; adc3.soc1IndependentNameMode = true; adc3.soc1Channel = "ADC_CH_ADCIN14"; adc3.soc1SampleWindow = 15; adc3.soc1Trigger = "ADC_TRIGGER_EPWM1_SOCA";
adc3.soc2Name = "BOOSTXL_ADC64"; adc3.soc2IndependentNameMode = true; adc3.soc2Channel = "ADC_CH_ADCIN10"; adc3.soc2SampleWindow = 15; adc3.soc2Trigger = "ADC_TRIGGER_EPWM1_SOCA";
adc3.soc3Name = "BOOSTXL_ADC69"; adc3.soc3IndependentNameMode = true; adc3.soc3Channel = "ADC_CH_ADCIN5";  adc3.soc3SampleWindow = 15; adc3.soc3Trigger = "ADC_TRIGGER_EPWM1_SOCA";

adc4.$name = "BOOSTXL_ADCD"; adc4.adcBase = "ADCD_BASE"; adc4.adcClockPrescaler = "ADC_CLK_DIV_4_0"; adc4.interruptPulseMode = "ADC_PULSE_END_OF_CONV";
adc4.enabledSOCs = ["ADC_SOC_NUMBER0","ADC_SOC_NUMBER1","ADC_SOC_NUMBER2"];
adc4.soc0Name = "BOOSTXL_ADC6";  adc4.soc0IndependentNameMode = true; adc4.soc0Channel = "ADC_CH_ADCIN12"; adc4.soc0SampleWindow = 15; adc4.soc0Trigger = "ADC_TRIGGER_EPWM1_SOCA";
adc4.soc1Name = "BOOSTXL_ADC30"; adc4.soc1IndependentNameMode = true; adc4.soc1Channel = "ADC_CH_ADCIN11"; adc4.soc1SampleWindow = 15; adc4.soc1Trigger = "ADC_TRIGGER_EPWM1_SOCA";
adc4.soc2Name = "BOOSTXL_ADC68"; adc4.soc2IndependentNameMode = true; adc4.soc2Channel = "ADC_CH_ADCIN15"; adc4.soc2SampleWindow = 15; adc4.soc2Trigger = "ADC_TRIGGER_EPWM1_SOCA";

adc5.$name = "BOOSTXL_ADCE"; adc5.adcBase = "ADCE_BASE"; adc5.adcClockPrescaler = "ADC_CLK_DIV_4_0"; adc5.interruptPulseMode = "ADC_PULSE_END_OF_CONV";
adc5.enabledSOCs = ["ADC_SOC_NUMBER0","ADC_SOC_NUMBER1","ADC_SOC_NUMBER2","ADC_SOC_NUMBER3"];
adc5.soc0Name = "BOOSTXL_ADC2";  adc5.soc0IndependentNameMode = true; adc5.soc0Channel = "ADC_CH_ADCIN16"; adc5.soc0SampleWindow = 15; adc5.soc0Trigger = "ADC_TRIGGER_EPWM1_SOCA";
adc5.soc1Name = "BOOSTXL_ADC23"; adc5.soc1IndependentNameMode = true; adc5.soc1Channel = "ADC_CH_ADCIN14"; adc5.soc1SampleWindow = 15; adc5.soc1Trigger = "ADC_TRIGGER_EPWM1_SOCA";
adc5.soc2Name = "BOOSTXL_ADC24"; adc5.soc2IndependentNameMode = true; adc5.soc2Channel = "ADC_CH_ADCIN12"; adc5.soc2SampleWindow = 15; adc5.soc2Trigger = "ADC_TRIGGER_EPWM1_SOCA";
adc5.soc3Name = "BOOSTXL_ADC29"; adc5.soc3IndependentNameMode = true; adc5.soc3Channel = "ADC_CH_ADCIN11"; adc5.soc3SampleWindow = 15; adc5.soc3Trigger = "ADC_TRIGGER_EPWM1_SOCA";

dac1.$name = "BOOSTXL_DACA";
dac1.enableOutput = true;
analog1.$name = "BOOSTXL_ANALOG";
analog1.useCase = "CUSTOM";
analog1.useInterfacePins = ["A0, B15, C15, DACA_OUT","A1, B7, D11, CMP1_DACL","A10, B1, C10, GPIO230","A11, B10, C0, PGA2_OUT","A12, C5","A14, B14, C4, PGA1_OUT","A2, B6, C9, PGA1_INP, GPIO224","A4, B8","A5","A6, D14, E14, GPIO228","A7, B30, C3, D12, E30","A9, GPIO227","B0, C11, GPIO253","B11, D16, E16, PGA3_INM","B2, C6, E12, GPIO226","B3, PGA2_INP, GPIO242","B4, C8, GPIO236","B5, D15, E15, PGA3_OUT","C1, E11, PGA3_INP","C14, GPIO247"];
adc1.analog = analog1;
adc2.analog = analog1;
adc3.analog = analog1;
adc4.analog = analog1;
adc5.analog = analog1;
dac1.analog = analog1;

function configurePwm(instance, name, peripheral, pinA, pinB) {
    instance.$name = name;
    instance.epwmTimebase_hsClockDiv = "EPWM_HSCLOCK_DIVIDER_1";
    instance.epwmTimebase_counterMode = "EPWM_COUNTER_MODE_UP_DOWN";
    instance.epwmTimebase_counterModeAfterSync = "EPWM_COUNT_MODE_UP_AFTER_SYNC";
    instance.epwmTimebase_phaseEnable = true;
    instance.epwmTimebase_period = 3750;
    instance.epwmCounterCompare_cmpA = 1875;
    instance.epwmCounterCompare_cmpB = 938;
    instance.epwmActionQualifier_EPWM_AQ_OUTPUT_A_ON_TIMEBASE_UP_CMPA = "EPWM_AQ_OUTPUT_HIGH";
    instance.epwmActionQualifier_EPWM_AQ_OUTPUT_A_ON_TIMEBASE_DOWN_CMPA = "EPWM_AQ_OUTPUT_LOW";
    instance.epwm.$assign = peripheral;
    instance.epwm.epwm_aPin.$assign = pinA;
    instance.epwm.epwm_bPin.$assign = pinB;
}
configurePwm(epwm1, "BOOSTXL_EPWM4039", "EPWM1", "GPIO0", "GPIO1");
epwm1.epwmEventTrigger_EPWM_SOC_A_triggerEnable = true;
epwm1.epwmEventTrigger_EPWM_SOC_A_triggerSource = "EPWM_SOC_TBCTR_PERIOD";
epwm1.epwmEventTrigger_EPWM_SOC_A_triggerEventPrescalar = "1";
configurePwm(epwm2, "BOOSTXL_EPWM3837", "EPWM2", "GPIO2", "GPIO3");
configurePwm(epwm3, "BOOSTXL_EPWM3635", "EPWM6", "GPIO10", "A24, D0, E0, GPIO11");
configurePwm(epwm4, "BOOSTXL_EPWM8079", "EPWM7", "A20, B20, C20, GPIO12", "A19, B19, C19, GPIO13");
configurePwm(epwm5, "BOOSTXL_EPWM7877", "EPWM4", "GPIO6", "GPIO7");
configurePwm(epwm6, "BOOSTXL_EPWM7675", "EPWM5", "GPIO37/TDO", "GPIO35/TDI");

gpio1.$name = "LED_R";
gpio1.direction = "GPIO_DIR_MODE_OUT";
gpio1.gpioPin.$assign = "A17, B17, C17, GPIO20";
gpio2.$name = "ENABLE_PORT"; gpio2.direction = "GPIO_DIR_MODE_OUT"; gpio2.initialValue = 0; gpio2.gpioPin.$assign = "A18, B18, C18, GPIO21";
gpio3.$name = "RELAY_PORT"; gpio3.direction = "GPIO_DIR_MODE_OUT"; gpio3.initialValue = 0; gpio3.gpioPin.$assign = "GPIO23";
gpio4.$name = "OVER_TEMPERATURE"; gpio4.direction = "GPIO_DIR_MODE_IN"; gpio4.gpioPin.$assign = "GPIO22";

sci1.$name = "LAUNCHXL_UART_USB";
sci1.selectRegisteredInterrupts = ["registerRxInt"];
sci1.enabledFIFOInterrupts = ["SCI_INT_RXFF"];
sci1.enabledErrorInterrupts = ["SCI_INT_FE","SCI_INT_OE"];
sci1.rxFifo = "SCI_FIFO_RX8";
sci1.baudRates = 115200;
sci1.sci.$assign = "SCIA";
sci1.sci.sci_rxPin.$assign = "A16, B16, C16, GPIO28";
sci1.sci.sci_txPin.$assign = "GPIO29";
sci1.sciRXInt.enableInterrupt = true;

mcan1.$name = "LAUNCHXL_MCAN";
mcan1.nomTimeSeg1 = 10;
mcan1.nomTimeSeg2 = 2;
mcan1.nomSynchJumpWidth = 2;
mcan1.nomRatePrescalar = 5;
mcan1.mcan.$assign = "MCANA";
