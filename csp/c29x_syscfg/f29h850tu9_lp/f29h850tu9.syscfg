/**
 * GMP LaunchPad baseline: two LEDs and the XDS110 back-channel UART.
 * @cliArgs --board "/boards/LAUNCHXL_F29H85X" --context "CPU1" --product "MCU_SDK_F29H85x@1.02.01.00"
 * @versions {"tool":"1.25.0+4237"}
 */

const divider15       = system.clockTree["PLL_REFDIV"];
divider15.divideValue = 1;

const multiplier1         = system.clockTree["PLL_IMULT"];
multiplier1.multiplyValue = 40;

const mux7       = system.clockTree["OSCCLKSRCSEL"];
mux7.inputSelect = "INTOSC2";

const led  = scripting.addModule("/driverlib/board_components/led", {}, false);
const led1 = led.addInstance();
const led2 = led.addInstance();
const uart = scripting.addModule("/driverlib/uart.js", {}, false);
const uart1 = uart.addInstance();

led1.$name     = "myBoardLED0";
led1.$hardware = system.deviceData.board.components.LED4;

led2.$name     = "myBoardLED1";
led2.$hardware = system.deviceData.board.components.LED5;

uart1.$name                    = "myUART0";
uart1.baudSelect               = "115200";
uart1.registerInterrupts       = false;
uart1.uart.$assign             = "UARTA";
uart1.uart.uart_txPin.$assign  = "GPIO38";
uart1.uart.uart_rxPin.$assign  = "GPIO43";
uart1.txQual.$name             = "myGPIOQUAL0";
uart1.rxQual.$name             = "myGPIOQUAL1";
uart1.periphClock.$name        = "driverlib_perClock0";
uart1.periphConfig.$name       = "driverlib_perConfig0";
