/**
 *
 * @cliArgs --device "Other" --part "Other" --package "Other" --product "TPLD@1.8.0+1529"
 * @versions {"tool":"1.28.0+4713"}
 */

/**
 * Define each context separately, before assigning them to individual modules.
 */
const context = await scripting.createContext(["--device", "TPLD2001", "--package", "DGS (VSSOP, 20)", "--variant", "default"]);
{
    const {scripting, system} = context;
    
    /**
     * Import the modules used in this configuration.
     */
    const DFF    = scripting.addModule("/ti/tpld/DFF", {}, false);
    const DFF1   = DFF.addInstance();
    const DFF2   = DFF.addInstance();
    const DFF3   = DFF.addInstance();
    const DFF4   = DFF.addInstance();
    const I2C    = scripting.addModule("/ti/tpld/I2C", {}, false);
    const I2C1   = I2C.addInstance();
    const LUT    = scripting.addModule("/ti/tpld/LUT", {}, false);
    const LUT1   = LUT.addInstance();
    const LUT2   = LUT.addInstance();
    const LUT3   = LUT.addInstance();
    const LUT4   = LUT.addInstance();
    const LUT5   = LUT.addInstance();
    const LUT6   = LUT.addInstance();
    const LUT7   = LUT.addInstance();
    const LUT8   = LUT.addInstance();
    const LUT9   = LUT.addInstance();
    const LUT10  = LUT.addInstance();
    const LUT11  = LUT.addInstance();
    const LUT12  = LUT.addInstance();
    const LUT13  = LUT.addInstance();
    const LUT14  = LUT.addInstance();
    const Label  = scripting.addModule("/ti/tpld/Label", {}, false);
    const Label1 = Label.addInstance();
    const Label2 = Label.addInstance();
    const Label3 = Label.addInstance();
    const Label4 = Label.addInstance();
    const Label5 = Label.addInstance();
    const Label6 = Label.addInstance();
    const OSC1   = scripting.addModule("/ti/tpld/OSC1", {}, false);
    const OSC11  = OSC1.addInstance();
    const PDLY   = scripting.addModule("/ti/tpld/PDLY", {}, false);
    const PDLY1  = PDLY.addInstance();
    const PIN    = scripting.addModule("/ti/tpld/PIN", {}, false);
    const PIN1   = PIN.addInstance();
    const PIN2   = PIN.addInstance();
    const PIN3   = PIN.addInstance();
    const PIN4   = PIN.addInstance();
    const PIN5   = PIN.addInstance();
    const PIN6   = PIN.addInstance();
    const PIN7   = PIN.addInstance();
    const PIN8   = PIN.addInstance();
    const PIN9   = PIN.addInstance();
    const PIN12  = PIN.addInstance();
    const PIN13  = PIN.addInstance();
    const PIN14  = PIN.addInstance();
    
    /**
     * Write custom configuration values to the imported modules.
     */
    DFF1.$name = "dff2";
    DFF1.rst   = 0;
    DFF1.mode  = 1;
    
    DFF2.$name = "dff0";
    DFF2.rst   = 0;
    DFF2.mode  = 1;
    
    DFF3.$name = "dff1";
    DFF3.rst   = 0;
    
    DFF4.$name = "dff3";
    DFF4.rst   = 0;
    
    I2C1.$name = "i2c0";
    
    LUT1.$name = "lut0";
    
    LUT2.$name    = "lut1";
    LUT2.function = "OR";
    
    LUT3.$name    = "lut2";
    LUT3.function = "OR";
    
    LUT4.$name    = "lut3";
    LUT4.function = "OR";
    
    LUT5.$name    = "lut4";
    LUT5.function = "OR";
    
    LUT6.$name    = "lut5";
    LUT6.function = "OR";
    LUT6.inputs   = 3;
    
    LUT7.$name    = "lut6";
    LUT7.function = "OR";
    
    LUT8.$name    = "lut8";
    LUT8.function = "INVA";
    
    LUT9.$name    = "lut9";
    LUT9.function = "INVA";
    
    LUT10.$name    = "lut10";
    LUT10.function = "OR";
    
    LUT11.$name    = "lut7";
    LUT11.inputs   = 4;
    LUT11.function = "OR";
    
    LUT12.$name    = "lut11";
    LUT12.function = "OR";
    LUT12.inputs   = 3;
    
    LUT13.$name    = "lut12";
    LUT13.function = "Equation";
    LUT13.cfg      = "!A & B";
    
    LUT14.$name    = "lut13";
    LUT14.function = "Equation";
    LUT14.cfg      = "A & !B";
    
    Label1.$name = "RMT_FAULT必须连接到MCU上，当RMT_FAULT为高电平时应当判断一下是否可以发送复位信号";
    
    Label2.$name = "IIC IN0 through\nIIC IN1 DESAT\nIIC IN2 MCU Fault\nIIC IN3 Remot Fault\nIIC IN4 Fault All";
    
    Label3.$name = "构造所存结构（Latch）";
    
    Label4.$name = "同步错误锁存";
    
    Label5.$name = "在没有故障的状态下才允许复位";
    
    Label6.$name = "在存在RMT错误时不允许恢复PWM";
    
    OSC11.$name = "25MHz0";
    
    PDLY1.$name = "pflt0";
    
    PIN1.$name     = "pin0";
    PIN1.$topLabel = "MCU_Fault";
    
    PIN2.$name     = "pin1";
    PIN2.$topLabel = "PWM_H";
    
    PIN3.$name     = "pin2";
    PIN3.$topLabel = "PWM_L";
    
    PIN4.$name      = "pin3";
    PIN4.pull_up_en = 1;
    PIN4.$topLabel  = "RESET";
    
    PIN5.$name     = "pin4";
    PIN5.$topLabel = "DESAT_H";
    
    PIN6.$name     = "pin5";
    PIN6.$topLabel = "DESAT_L";
    
    PIN7.$name     = "pin7";
    PIN7.type      = "DOUT";
    PIN7.$topLabel = "FLT_DESAT";
    
    PIN8.$name     = "pin8";
    PIN8.$topLabel = "RMT_FAULT";
    
    PIN9.$name     = "pin9";
    PIN9.type      = "DOUT";
    PIN9.$topLabel = "FAULT_OUT";
    
    const PIN10      = PIN.addInstance({}, false);
    I2C1.pin5        = PIN10;
    PIN10.hw.$assign = "IO6";
    
    const PIN11      = PIN.addInstance({}, false);
    I2C1.pin6        = PIN11;
    PIN11.hw.$assign = "IO7";
    
    PIN12.$name     = "pin6";
    PIN12.type      = "DOUT";
    PIN12.$topLabel = "FAULT_ALL";
    
    PIN13.$name     = "pin10";
    PIN13.type      = "DOUT";
    PIN13.$topLabel = "PWM_L_O";
    
    PIN14.$name     = "pin11";
    PIN14.type      = "DOUT";
    PIN14.$topLabel = "PMW_H_O";
    
    const SYSTEM = scripting.addModule("/ti/tpld/SYSTEM", {}, false);
    
    /**
     * Connections between modules.
     */
    scripting.connect(DFF1, "IN", LUT2, "OUT");
    scripting.connect(DFF1, "CLK", LUT8, "OUT");
    scripting.connect(DFF1, "OUT", LUT2, "B");
    scripting.connect(DFF1, "OUT", LUT6, "A");
    scripting.connect(DFF1, "OUT", LUT5, "A");
    scripting.connect(DFF1, "OUT", I2C1, "VIR_OUT0");
    scripting.connect(DFF1, "NRST_NSET", LUT11, "OUT");
    scripting.connect(DFF2, "IN", LUT4, "OUT");
    scripting.connect(DFF2, "CLK", LUT9, "OUT");
    scripting.connect(DFF2, "OUT", LUT4, "B");
    scripting.connect(DFF2, "OUT", LUT6, "B");
    scripting.connect(DFF2, "OUT", LUT5, "B");
    scripting.connect(DFF2, "OUT", I2C1, "VIR_OUT1");
    scripting.connect(DFF2, "NRST_NSET", LUT11, "OUT");
    scripting.connect(DFF3, "IN", LUT7, "OUT");
    scripting.connect(DFF3, "CLK", OSC11, "OUT0");
    scripting.connect(DFF3, "OUT", LUT7, "B");
    scripting.connect(DFF3, "OUT", LUT12, "B");
    scripting.connect(DFF3, "OUT", I2C1, "VIR_OUT3");
    scripting.connect(DFF3, "NRST_NSET", LUT11, "OUT");
    scripting.connect(DFF4, "IN", LUT10, "OUT");
    scripting.connect(DFF4, "CLK", OSC11, "OUT0");
    scripting.connect(DFF4, "OUT", LUT6, "C");
    scripting.connect(DFF4, "OUT", LUT10, "B");
    scripting.connect(DFF4, "OUT", I2C1, "VIR_OUT2");
    scripting.connect(DFF4, "NRST_NSET", LUT11, "OUT");
    scripting.connect(LUT1, "A", PIN2, "OUT");
    scripting.connect(LUT1, "B", PIN3, "OUT");
    scripting.connect(LUT1, "OUT", LUT2, "A");
    scripting.connect(LUT1, "OUT", LUT8, "A");
    scripting.connect(LUT1, "OUT", LUT11, "A");
    scripting.connect(LUT3, "A", PIN5, "OUT");
    scripting.connect(LUT3, "B", PIN6, "OUT");
    scripting.connect(LUT3, "OUT", LUT4, "A");
    scripting.connect(LUT3, "OUT", LUT9, "A");
    scripting.connect(LUT3, "OUT", LUT11, "B");
    scripting.connect(LUT5, "OUT", PIN7, "IN");
    scripting.connect(LUT6, "OUT", PIN9, "IN");
    scripting.connect(LUT6, "OUT", LUT12, "A");
    scripting.connect(LUT7, "A", PDLY1, "OUT");
    scripting.connect(LUT10, "A", PIN1, "OUT");
    scripting.connect(LUT11, "C", PIN1, "OUT");
    scripting.connect(LUT11, "D", PIN4, "OUT");
    scripting.connect(LUT12, "OUT", PIN12, "IN");
    scripting.connect(LUT12, "OUT", LUT14, "B");
    scripting.connect(LUT12, "OUT", LUT13, "A");
    scripting.connect(LUT12, "C", PDLY1, "OUT");
    scripting.connect(LUT13, "B", PIN2, "OUT");
    scripting.connect(LUT13, "OUT", PIN14, "IN");
    scripting.connect(LUT14, "A", PIN3, "OUT");
    scripting.connect(LUT14, "OUT", PIN13, "IN");
    scripting.connect(PDLY1, "IN", PIN8, "OUT");
    
    /**
     * (x,y) coordinates for modules that are displayed in a graph.
     */
    DFF1.$position   = [535,-10];
    DFF2.$position   = [535,245];
    DFF3.$position   = [520,690];
    DFF4.$position   = [525,480];
    I2C1.$position   = [1205,760];
    LUT1.$position   = [190,-35];
    LUT2.$position   = [370,-25];
    LUT3.$position   = [180,220];
    LUT4.$position   = [370,230];
    LUT5.$position   = [765,235];
    LUT6.$position   = [770,465];
    LUT7.$position   = [370,675];
    LUT8.$position   = [370,105];
    LUT9.$position   = [370,355];
    LUT10.$position  = [370,465];
    LUT11.$position  = [370,825];
    LUT12.$position  = [950,525];
    LUT13.$position  = [1080,-100];
    LUT14.$position  = [1080,65];
    Label1.$position = [-340,635];
    Label2.$position = [915,635];
    Label3.$position = [445,-40];
    Label4.$position = [535,450];
    Label5.$position = [290,920];
    Label6.$position = [995,610];
    OSC11.$position  = [0,945];
    PDLY1.$position  = [180,665];
    PIN1.$position   = [0,470];
    PIN2.$position   = [10,-55];
    PIN3.$position   = [10,15];
    PIN4.$position   = [0,855];
    PIN5.$position   = [0,200];
    PIN6.$position   = [0,275];
    PIN7.$position   = [1205,250];
    PIN8.$position   = [0,680];
    PIN9.$position   = [1205,460];
    PIN10.$position  = [1070,665];
    PIN11.$position  = [1070,720];
    PIN12.$position  = [1205,540];
    PIN13.$position  = [1205,15];
    PIN14.$position  = [1205,-55];
    
    /**
     * Pinmux solution for unlocked pins/peripherals. This ensures that minor changes to the automatic solver in a future
     * version of the tool will not impact the pinmux you originally saw.  These lines can be completely deleted in order to
     * re-solve from scratch.
     */
    DFF1.hw.$suggestSolution   = "LUT4_1";
    DFF2.hw.$suggestSolution   = "LUT3_11";
    DFF3.hw.$suggestSolution   = "LUT3_10";
    DFF4.hw.$suggestSolution   = "LUT3_9";
    I2C1.hw.$suggestSolution   = "SER_COMM";
    LUT1.hw.$suggestSolution   = "LUT3_8";
    LUT2.hw.$suggestSolution   = "LUT3_7";
    LUT3.hw.$suggestSolution   = "LUT3_6";
    LUT4.hw.$suggestSolution   = "LUT3_5";
    LUT5.hw.$suggestSolution   = "LUT3_4";
    LUT6.hw.$suggestSolution   = "LUT3_1";
    LUT7.hw.$suggestSolution   = "LUT3_3";
    LUT8.hw.$suggestSolution   = "LUT3_2";
    LUT9.hw.$suggestSolution   = "LUT2_3";
    LUT10.hw.$suggestSolution  = "LUT2_2";
    LUT11.hw.$suggestSolution  = "LUT4_0";
    LUT12.hw.$suggestSolution  = "LUT3_0";
    LUT13.hw.$suggestSolution  = "LUT2_1";
    LUT14.hw.$suggestSolution  = "LUT2_0";
    OSC11.hw.$suggestSolution  = "OSC2";
    PDLY1.hw.$suggestSolution  = "PFLT0";
    PIN1.hw.$suggestSolution   = "IN0";
    PIN2.hw.$suggestSolution   = "IO8";
    PIN3.hw.$suggestSolution   = "IO9";
    PIN4.hw.$suggestSolution   = "IO10";
    PIN5.hw.$suggestSolution   = "IO11";
    PIN6.hw.$suggestSolution   = "IO12";
    PIN7.hw.$suggestSolution   = "IO5";
    PIN8.hw.$suggestSolution   = "IO13";
    PIN9.hw.$suggestSolution   = "IO4";
    PIN12.hw.$suggestSolution  = "IO3";
    PIN13.hw.$suggestSolution  = "IO2";
    PIN14.hw.$suggestSolution  = "IO1";
    SYSTEM.hw.$suggestSolution = "MISC";
    
}


/**
 * Import the modules used in this configuration.
 */
const Device     = scripting.addModule("/ti/tpld/Device", {}, false);
const Device1    = Device.addInstance();
const GND        = scripting.addModule("/ti/tpld/GND", {}, false);
const GND1       = GND.addInstance();
const Simulation = scripting.addModule("/ti/tpld/Simulation");
const VCC        = scripting.addModule("/ti/tpld/VCC", {}, false);
const VCC1       = VCC.addInstance();

/**
 * Write custom configuration values to the imported modules.
 */
Device1.$name   = "U1";
Device1.context = context;

GND1.$name = "GND0";

Simulation.tstop = { val: 1, units: "s" };
Simulation.tstep = { val: 1, units: "ms" };

VCC1.$name = "VCC0";

/**
 * Connections between modules.
 */
scripting.connect(Device1, "VCC", VCC1, "OUT");
scripting.connect(Device1, "GND", GND1, "OUT");

/**
 * (x,y) coordinates for modules that are displayed in a graph.
 */
Device1.$position = [385,250];
GND1.$position    = [160,300];
VCC1.$position    = [165,205];
