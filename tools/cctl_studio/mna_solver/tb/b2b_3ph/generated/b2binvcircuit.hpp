#pragma once

// Generated by GMP mna_solver/cpp_codegen.py from B2B_INV.CIR.
// Source SHA-256: 29dd58452859fb3d7ef583318ad36b65bff3da7a26cdaf445da34bb85de2240a
// Matrix equivalence tolerance: 9.9999999999999998e-13
// Matrix backend: eigen
// Selection states: 15625; stored reachable states: 15625; unique calculation states: 15625.
// Do not hand-edit; regenerate from the circuit-data JSON file.

#include <Eigen/Dense>

#include <array>
#include <cstddef>
#include <cstdint>
#include <stdexcept>
#include <string>
#include <string_view>
#include <vector>
#include <cstring>
#include <filesystem>
#include <fstream>
#include <limits>
#include <memory>
#include <vector>

class B2bInvCircuit {
public:
    static constexpr std::size_t state_count = 23;
    static constexpr std::size_t signal_count = 35;
    static constexpr std::size_t analog_input_count = 3;
    static constexpr std::size_t pwm_input_count = 12;
    static constexpr std::size_t topology_count = 15625;
    static constexpr std::size_t stored_topology_count = 15625;
    static constexpr std::size_t calculation_state_count = 15625;
    static constexpr const char* matrix_backend = "eigen";
    static constexpr const char* matrix_storage = "archive";
    static constexpr const char* archive_filename = "b2binvcircuit.archive";
    static constexpr std::size_t state_matrix_count = 31250;
    static constexpr std::size_t input_matrix_count = 3096;
    static constexpr std::size_t state_vector_count = 29793;
    static constexpr std::size_t signal_matrix_count = 1;
    static constexpr std::size_t signal_input_matrix_count = 1;
    static constexpr std::size_t signal_vector_count = 1;
    static constexpr double normal_step_s = 1.0000000000000001e-07;
    static constexpr double short_step_s = 1.0000000000000001e-09;
    static constexpr double matrix_tolerance = 9.9999999999999998e-13;
    static constexpr const char* discretization_method = "backward_euler";
    enum class HalfBridgeOperatingMode : std::uint8_t {
        blocked,
        lower_channel,
        lower_passive_rectification,
        upper_channel,
        upper_passive_rectification,
    };
    static constexpr std::size_t half_bridge_count = 6;
    using HalfBridgeOperatingModes =
        std::array<HalfBridgeOperatingMode, half_bridge_count>;


    struct Inputs {
        std::uint32_t PWM1{0U};
        std::uint32_t PWM10{0U};
        std::uint32_t PWM11{0U};
        std::uint32_t PWM12{0U};
        std::uint32_t PWM2{0U};
        std::uint32_t PWM3{0U};
        std::uint32_t PWM4{0U};
        std::uint32_t PWM5{0U};
        std::uint32_t PWM6{0U};
        std::uint32_t PWM7{0U};
        std::uint32_t PWM8{0U};
        std::uint32_t PWM9{0U};
        double VS4{5.0};
        double VS3{5.0};
        double VS2{5.0};
    };

    struct Outputs {
        double UBUS{0.0};
        double n_20{0.0};
        double LGRID_A{0.0};
        double LGRID_B{0.0};
        double LGRID_C{0.0};
        double VAM3{0.0};
        double VAM2{0.0};
        double VAM1{0.0};
        double n_32{0.0};
        double n_31{0.0};
        double n_30{0.0};

        double operator[](std::string_view name) const {
            if (name == "V(UBUS)" || name == "UBUS") return UBUS;
            if (name == "V(20)" || name == "n_20") return n_20;
            if (name == "I(LGRID_A)" || name == "LGRID_A") return LGRID_A;
            if (name == "I(LGRID_B)" || name == "LGRID_B") return LGRID_B;
            if (name == "I(LGRID_C)" || name == "LGRID_C") return LGRID_C;
            if (name == "I(VAM3)" || name == "VAM3") return VAM3;
            if (name == "I(VAM2)" || name == "VAM2") return VAM2;
            if (name == "I(VAM1)" || name == "VAM1") return VAM1;
            if (name == "V(32,28)" || name == "n_32") return n_32;
            if (name == "V(31,28)" || name == "n_31") return n_31;
            if (name == "V(30,28)" || name == "n_30") return n_30;
            throw std::out_of_range("unknown circuit output: " + std::string(name));
        }
    };

    Outputs output{};

    explicit B2bInvCircuit(
        const std::filesystem::path& archive_path = std::filesystem::path(archive_filename))
        : archive_(load_archive(archive_path)) { reset(); }

    void reset() {
        state_.setZero();
        signals_.setZero();
        body_on_.fill(false);
        half_bridge_modes_.fill(HalfBridgeOperatingMode::blocked);
        last_topology_index_ = 0;
        last_calculation_state_index_ = topology_to_calculation_state()[0];
        output = Outputs{};
    }

    const Outputs& step_short(const Inputs& inputs) { return step(inputs, true); }
    const Outputs& step_normal(const Inputs& inputs) { return step(inputs, false); }

    const Outputs& step_short(std::uint32_t PWM1, std::uint32_t PWM10, std::uint32_t PWM11, std::uint32_t PWM12, std::uint32_t PWM2, std::uint32_t PWM3, std::uint32_t PWM4, std::uint32_t PWM5, std::uint32_t PWM6, std::uint32_t PWM7, std::uint32_t PWM8, std::uint32_t PWM9, double VS4, double VS3, double VS2) {
        return step_short(Inputs{PWM1, PWM10, PWM11, PWM12, PWM2, PWM3, PWM4, PWM5, PWM6, PWM7, PWM8, PWM9, VS4, VS3, VS2});
    }

    const Outputs& step_normal(std::uint32_t PWM1, std::uint32_t PWM10, std::uint32_t PWM11, std::uint32_t PWM12, std::uint32_t PWM2, std::uint32_t PWM3, std::uint32_t PWM4, std::uint32_t PWM5, std::uint32_t PWM6, std::uint32_t PWM7, std::uint32_t PWM8, std::uint32_t PWM9, double VS4, double VS3, double VS2) {
        return step_normal(Inputs{PWM1, PWM10, PWM11, PWM12, PWM2, PWM3, PWM4, PWM5, PWM6, PWM7, PWM8, PWM9, VS4, VS3, VS2});
    }

    const Outputs& run(std::uint32_t PWM1, std::uint32_t PWM10, std::uint32_t PWM11, std::uint32_t PWM12, std::uint32_t PWM2, std::uint32_t PWM3, std::uint32_t PWM4, std::uint32_t PWM5, std::uint32_t PWM6, std::uint32_t PWM7, std::uint32_t PWM8, std::uint32_t PWM9, double VS4, double VS3, double VS2) {
        return step_normal(PWM1, PWM10, PWM11, PWM12, PWM2, PWM3, PWM4, PWM5, PWM6, PWM7, PWM8, PWM9, VS4, VS3, VS2);
    }

    const Outputs& operator()(std::uint32_t PWM1, std::uint32_t PWM10, std::uint32_t PWM11, std::uint32_t PWM12, std::uint32_t PWM2, std::uint32_t PWM3, std::uint32_t PWM4, std::uint32_t PWM5, std::uint32_t PWM6, std::uint32_t PWM7, std::uint32_t PWM8, std::uint32_t PWM9, double VS4, double VS3, double VS2) {
        return run(PWM1, PWM10, PWM11, PWM12, PWM2, PWM3, PWM4, PWM5, PWM6, PWM7, PWM8, PWM9, VS4, VS3, VS2);
    }

    double operator[](std::string_view name) const { return output[name]; }
    const auto& state() const noexcept { return state_; }
    std::size_t last_topology_index() const noexcept { return last_topology_index_; }
    std::size_t last_calculation_state_index() const noexcept { return last_calculation_state_index_; }
    const HalfBridgeOperatingModes& last_half_bridge_modes() const noexcept {
        return half_bridge_modes_;
    }


private:
    using StateMatrix = Eigen::Matrix<double, 23, 23>;
    using InputMatrix = Eigen::Matrix<double, 23, 3>;
    using StateVector = Eigen::Matrix<double, 23, 1>;
    using SignalMatrix = Eigen::Matrix<double, 35, 23>;
    using SignalInputMatrix = Eigen::Matrix<double, 35, 3>;
    using SignalVector = Eigen::Matrix<double, 35, 1>;
    using InputVector = Eigen::Matrix<double, 3, 1>;

    struct CalculationState {
        std::size_t normal_A;
        std::size_t normal_B;
        std::size_t normal_bias;
        std::size_t short_A;
        std::size_t short_B;
        std::size_t short_bias;
        std::size_t C;
        std::size_t D;
        std::size_t output_bias;
    };

    static constexpr std::size_t invalid_topology_index = static_cast<std::size_t>(-1);

    template <typename Matrix>
    using MatrixPool = std::vector<Matrix, Eigen::aligned_allocator<Matrix>>;

    struct ArchiveData {
        MatrixPool<StateMatrix> state_matrices;
        MatrixPool<InputMatrix> input_matrices;
        MatrixPool<StateVector> state_vectors;
        MatrixPool<SignalMatrix> signal_matrices;
        MatrixPool<SignalInputMatrix> signal_input_matrices;
        MatrixPool<SignalVector> signal_vectors;
        std::vector<CalculationState> calculation_states;
        std::vector<std::size_t> topology_to_calculation_state;
    };

    static std::uint32_t read_u32(const std::vector<std::uint8_t>& bytes,
                                  std::size_t& cursor) {
        require_bytes(bytes, cursor, sizeof(std::uint32_t));
        std::uint32_t value = 0U;
        std::memcpy(&value, bytes.data() + cursor, sizeof(value));
        cursor += sizeof(value);
        return value;
    }

    static std::uint64_t read_u64(const std::vector<std::uint8_t>& bytes,
                                  std::size_t& cursor) {
        require_bytes(bytes, cursor, sizeof(std::uint64_t));
        std::uint64_t value = 0U;
        std::memcpy(&value, bytes.data() + cursor, sizeof(value));
        cursor += sizeof(value);
        return value;
    }

    static double read_f64(const std::vector<std::uint8_t>& bytes,
                           std::size_t& cursor) {
        require_bytes(bytes, cursor, sizeof(double));
        double value = 0.0;
        std::memcpy(&value, bytes.data() + cursor, sizeof(value));
        cursor += sizeof(value);
        return value;
    }

    static void require_bytes(const std::vector<std::uint8_t>& bytes,
                              std::size_t cursor, std::size_t count) {
        if (cursor > bytes.size() || count > bytes.size() - cursor)
            throw std::runtime_error("truncated matrix archive");
    }

    static std::uint64_t fnv1a64(const std::uint8_t* data, std::size_t size) noexcept {
        std::uint64_t value = UINT64_C(14695981039346656037);
        for (std::size_t index = 0U; index < size; ++index) {
            value ^= data[index];
            value *= UINT64_C(1099511628211);
        }
        return value;
    }

    template <typename Matrix>
    static void read_matrix_pool(MatrixPool<Matrix>& pool, std::size_t count,
                                 const std::vector<std::uint8_t>& bytes,
                                 std::size_t& cursor) {
        constexpr std::size_t coefficient_count =
            static_cast<std::size_t>(Matrix::SizeAtCompileTime);
        constexpr std::size_t matrix_bytes = coefficient_count * sizeof(double);
        pool.resize(count);
        if constexpr (matrix_bytes == 0U)
            return;
        if (count > (std::numeric_limits<std::size_t>::max)() / matrix_bytes)
            throw std::runtime_error("matrix archive pool size overflow");
        require_bytes(bytes, cursor, count * matrix_bytes);
        for (auto& matrix : pool) {
            std::memcpy(matrix.data(), bytes.data() + cursor, matrix_bytes);
            cursor += matrix_bytes;
        }
    }

    static std::shared_ptr<const ArchiveData> load_archive(
        const std::filesystem::path& path) {
        const std::uint16_t endian_probe = 1U;
        if (*reinterpret_cast<const std::uint8_t*>(&endian_probe) != 1U)
            throw std::runtime_error("matrix archives currently require a little-endian host");

        std::ifstream input(path, std::ios::binary | std::ios::ate);
        if (!input)
            throw std::runtime_error("cannot open matrix archive: " + path.string());
        const std::streamoff end = input.tellg();
        if (end < 0 || static_cast<std::uintmax_t>(end) >
                           (std::numeric_limits<std::size_t>::max)())
            throw std::runtime_error("invalid matrix archive size: " + path.string());
        std::vector<std::uint8_t> bytes(static_cast<std::size_t>(end));
        input.seekg(0, std::ios::beg);
        if (!bytes.empty() &&
            !input.read(reinterpret_cast<char*>(bytes.data()),
                        static_cast<std::streamsize>(bytes.size())))
            throw std::runtime_error("cannot read matrix archive: " + path.string());

        constexpr std::array<std::uint8_t, 8U> expected_magic{{
            0x47U, 0x4dU, 0x50U, 0x4dU, 0x4eU, 0x41U, 0x31U, 0x00U
        }};
        constexpr std::array<std::uint8_t, 32U> expected_source_hash{{
            0x33U, 0x8bU, 0x57U, 0x18U, 0x3dU, 0xf0U, 0x65U, 0xa7U, 0x35U, 0x0bU, 0xfbU, 0xffU, 0xccU, 0xe7U, 0xdbU, 0x7cU, 0x40U, 0x98U, 0x80U, 0x1cU, 0x7eU, 0xf8U, 0x1dU, 0xe3U, 0xa7U, 0x94U, 0x34U, 0x75U, 0x66U, 0x4eU, 0x43U, 0xdbU
        }};
        require_bytes(bytes, 0U, expected_magic.size());
        if (std::memcmp(bytes.data(), expected_magic.data(), expected_magic.size()) != 0)
            throw std::runtime_error("invalid matrix archive magic: " + path.string());

        std::size_t cursor = expected_magic.size();
        const auto expect_u32 = [&](std::uint32_t expected, const char* field) {
            if (read_u32(bytes, cursor) != expected)
                throw std::runtime_error(std::string("matrix archive mismatch: ") + field);
        };
        expect_u32(1U, "version");
        expect_u32(140U, "header size");
        expect_u32(0x01020304U, "endianness");
        expect_u32(8U, "scalar size");
        expect_u32(static_cast<std::uint32_t>(state_count), "state count");
        expect_u32(static_cast<std::uint32_t>(analog_input_count), "input count");
        expect_u32(static_cast<std::uint32_t>(signal_count), "signal count");
        expect_u32(static_cast<std::uint32_t>(stored_topology_count), "topology count");
        expect_u32(static_cast<std::uint32_t>(calculation_state_count),
                   "calculation-state count");
        expect_u32(static_cast<std::uint32_t>(state_matrix_count),
                   "state-matrix count");
        expect_u32(static_cast<std::uint32_t>(input_matrix_count),
                   "input-matrix count");
        expect_u32(static_cast<std::uint32_t>(state_vector_count),
                   "state-vector count");
        expect_u32(static_cast<std::uint32_t>(signal_matrix_count),
                   "signal-matrix count");
        expect_u32(static_cast<std::uint32_t>(signal_input_matrix_count),
                   "signal-input-matrix count");
        expect_u32(static_cast<std::uint32_t>(signal_vector_count),
                   "signal-vector count");
        if (read_f64(bytes, cursor) != normal_step_s ||
            read_f64(bytes, cursor) != short_step_s ||
            read_f64(bytes, cursor) != matrix_tolerance)
            throw std::runtime_error("matrix archive solver metadata mismatch");
        require_bytes(bytes, cursor, expected_source_hash.size());
        if (std::memcmp(bytes.data() + cursor, expected_source_hash.data(),
                        expected_source_hash.size()) != 0)
            throw std::runtime_error("matrix archive source hash mismatch");
        cursor += expected_source_hash.size();
        const std::uint64_t payload_size = read_u64(bytes, cursor);
        const std::uint64_t payload_hash = read_u64(bytes, cursor);
        if (cursor != 140U ||
            payload_size != static_cast<std::uint64_t>(bytes.size() - cursor))
            throw std::runtime_error("matrix archive payload size mismatch");
        if (fnv1a64(bytes.data() + cursor, static_cast<std::size_t>(payload_size)) !=
            payload_hash)
            throw std::runtime_error("matrix archive payload checksum mismatch");

        auto result = std::make_shared<ArchiveData>();
        result->topology_to_calculation_state.resize(stored_topology_count);
        for (auto& value : result->topology_to_calculation_state) {
            value = read_u32(bytes, cursor);
            if (value >= calculation_state_count)
                throw std::runtime_error("matrix archive topology index is out of range");
        }
        result->calculation_states.resize(calculation_state_count);
        for (auto& state : result->calculation_states) {
            state.normal_A = read_u32(bytes, cursor);
            state.normal_B = read_u32(bytes, cursor);
            state.normal_bias = read_u32(bytes, cursor);
            state.short_A = read_u32(bytes, cursor);
            state.short_B = read_u32(bytes, cursor);
            state.short_bias = read_u32(bytes, cursor);
            state.C = read_u32(bytes, cursor);
            state.D = read_u32(bytes, cursor);
            state.output_bias = read_u32(bytes, cursor);
            if (state.normal_A >= state_matrix_count ||
                state.short_A >= state_matrix_count ||
                state.normal_B >= input_matrix_count ||
                state.short_B >= input_matrix_count ||
                state.normal_bias >= state_vector_count ||
                state.short_bias >= state_vector_count ||
                state.C >= signal_matrix_count ||
                state.D >= signal_input_matrix_count ||
                state.output_bias >= signal_vector_count)
                throw std::runtime_error("matrix archive calculation-state index is out of range");
        }
        read_matrix_pool(result->state_matrices, state_matrix_count, bytes, cursor);
        read_matrix_pool(result->input_matrices, input_matrix_count, bytes, cursor);
        read_matrix_pool(result->state_vectors, state_vector_count, bytes, cursor);
        read_matrix_pool(result->signal_matrices, signal_matrix_count, bytes, cursor);
        read_matrix_pool(result->signal_input_matrices, signal_input_matrix_count,
                         bytes, cursor);
        read_matrix_pool(result->signal_vectors, signal_vector_count, bytes, cursor);
        if (cursor != bytes.size())
            throw std::runtime_error("matrix archive contains trailing data");
        return result;
    }

    const MatrixPool<StateMatrix>& state_matrices() const noexcept {
        return archive_->state_matrices;
    }
    const MatrixPool<InputMatrix>& input_matrices() const noexcept {
        return archive_->input_matrices;
    }
    const MatrixPool<StateVector>& state_vectors() const noexcept {
        return archive_->state_vectors;
    }
    const MatrixPool<SignalMatrix>& signal_matrices() const noexcept {
        return archive_->signal_matrices;
    }
    const MatrixPool<SignalInputMatrix>& signal_input_matrices() const noexcept {
        return archive_->signal_input_matrices;
    }
    const MatrixPool<SignalVector>& signal_vectors() const noexcept {
        return archive_->signal_vectors;
    }
    const std::vector<CalculationState>& calculation_states() const noexcept {
        return archive_->calculation_states;
    }
    const std::vector<std::size_t>& topology_to_calculation_state() const noexcept {
        return archive_->topology_to_calculation_state;
    }

    static constexpr std::size_t resolve_stored_topology(
        std::size_t selection_index) noexcept {
        return selection_index;
    }

    std::size_t select_topology(const Inputs& inputs) {
        constexpr double hysteresis = 9.9999999999999995e-07;
        std::size_t topology_index = 0U;
        topology_index *= 5U;
        if (inputs.PWM3 != 0U && inputs.PWM4 != 0U)
            throw std::runtime_error("half bridge has simultaneous upper/lower channel commands: PWM3/PWM4");
        if (inputs.PWM3 != 0U) {
            body_on_[0] = body_on_[1] = false;
            half_bridge_modes_[0] = HalfBridgeOperatingMode::upper_channel;
            topology_index += 3U;
        } else if (inputs.PWM4 != 0U) {
            body_on_[0] = body_on_[1] = false;
            half_bridge_modes_[0] = HalfBridgeOperatingMode::lower_channel;
            topology_index += 1U;
        } else {
            const double upper_reverse_voltage_0 = signals_(12) - signals_(11);
            const double lower_reverse_voltage_1 = signals_(14) - signals_(13);
            constexpr double upper_body_threshold_0 = 0.80000000000000004;
            constexpr double lower_body_threshold_1 = 0.80000000000000004;
            body_on_[0] = upper_reverse_voltage_0 >= upper_body_threshold_0 + (body_on_[0] ? -hysteresis : hysteresis);
            body_on_[1] = lower_reverse_voltage_1 >= lower_body_threshold_1 + (body_on_[1] ? -hysteresis : hysteresis);
            if (body_on_[0] && body_on_[1])
                throw std::runtime_error("half bridge entered impossible simultaneous reverse conduction: PWM3/PWM4");
            if (body_on_[0]) {
                half_bridge_modes_[0] = HalfBridgeOperatingMode::upper_passive_rectification;
                topology_index += 4U;
            } else if (body_on_[1]) {
                half_bridge_modes_[0] = HalfBridgeOperatingMode::lower_passive_rectification;
                topology_index += 2U;
            } else {
                half_bridge_modes_[0] = HalfBridgeOperatingMode::blocked;
            }
        }
        topology_index *= 5U;
        if (inputs.PWM1 != 0U && inputs.PWM2 != 0U)
            throw std::runtime_error("half bridge has simultaneous upper/lower channel commands: PWM1/PWM2");
        if (inputs.PWM1 != 0U) {
            body_on_[2] = body_on_[3] = false;
            half_bridge_modes_[1] = HalfBridgeOperatingMode::upper_channel;
            topology_index += 3U;
        } else if (inputs.PWM2 != 0U) {
            body_on_[2] = body_on_[3] = false;
            half_bridge_modes_[1] = HalfBridgeOperatingMode::lower_channel;
            topology_index += 1U;
        } else {
            const double upper_reverse_voltage_2 = signals_(16) - signals_(15);
            const double lower_reverse_voltage_3 = signals_(18) - signals_(17);
            constexpr double upper_body_threshold_2 = 0.80000000000000004;
            constexpr double lower_body_threshold_3 = 0.80000000000000004;
            body_on_[2] = upper_reverse_voltage_2 >= upper_body_threshold_2 + (body_on_[2] ? -hysteresis : hysteresis);
            body_on_[3] = lower_reverse_voltage_3 >= lower_body_threshold_3 + (body_on_[3] ? -hysteresis : hysteresis);
            if (body_on_[2] && body_on_[3])
                throw std::runtime_error("half bridge entered impossible simultaneous reverse conduction: PWM1/PWM2");
            if (body_on_[2]) {
                half_bridge_modes_[1] = HalfBridgeOperatingMode::upper_passive_rectification;
                topology_index += 4U;
            } else if (body_on_[3]) {
                half_bridge_modes_[1] = HalfBridgeOperatingMode::lower_passive_rectification;
                topology_index += 2U;
            } else {
                half_bridge_modes_[1] = HalfBridgeOperatingMode::blocked;
            }
        }
        topology_index *= 5U;
        if (inputs.PWM5 != 0U && inputs.PWM6 != 0U)
            throw std::runtime_error("half bridge has simultaneous upper/lower channel commands: PWM5/PWM6");
        if (inputs.PWM5 != 0U) {
            body_on_[4] = body_on_[5] = false;
            half_bridge_modes_[2] = HalfBridgeOperatingMode::upper_channel;
            topology_index += 3U;
        } else if (inputs.PWM6 != 0U) {
            body_on_[4] = body_on_[5] = false;
            half_bridge_modes_[2] = HalfBridgeOperatingMode::lower_channel;
            topology_index += 1U;
        } else {
            const double upper_reverse_voltage_4 = signals_(20) - signals_(19);
            const double lower_reverse_voltage_5 = signals_(22) - signals_(21);
            constexpr double upper_body_threshold_4 = 0.80000000000000004;
            constexpr double lower_body_threshold_5 = 0.80000000000000004;
            body_on_[4] = upper_reverse_voltage_4 >= upper_body_threshold_4 + (body_on_[4] ? -hysteresis : hysteresis);
            body_on_[5] = lower_reverse_voltage_5 >= lower_body_threshold_5 + (body_on_[5] ? -hysteresis : hysteresis);
            if (body_on_[4] && body_on_[5])
                throw std::runtime_error("half bridge entered impossible simultaneous reverse conduction: PWM5/PWM6");
            if (body_on_[4]) {
                half_bridge_modes_[2] = HalfBridgeOperatingMode::upper_passive_rectification;
                topology_index += 4U;
            } else if (body_on_[5]) {
                half_bridge_modes_[2] = HalfBridgeOperatingMode::lower_passive_rectification;
                topology_index += 2U;
            } else {
                half_bridge_modes_[2] = HalfBridgeOperatingMode::blocked;
            }
        }
        topology_index *= 5U;
        if (inputs.PWM9 != 0U && inputs.PWM10 != 0U)
            throw std::runtime_error("half bridge has simultaneous upper/lower channel commands: PWM9/PWM10");
        if (inputs.PWM9 != 0U) {
            body_on_[6] = body_on_[7] = false;
            half_bridge_modes_[3] = HalfBridgeOperatingMode::upper_channel;
            topology_index += 3U;
        } else if (inputs.PWM10 != 0U) {
            body_on_[6] = body_on_[7] = false;
            half_bridge_modes_[3] = HalfBridgeOperatingMode::lower_channel;
            topology_index += 1U;
        } else {
            const double upper_reverse_voltage_6 = signals_(24) - signals_(23);
            const double lower_reverse_voltage_7 = signals_(26) - signals_(25);
            constexpr double upper_body_threshold_6 = 0.80000000000000004;
            constexpr double lower_body_threshold_7 = 0.80000000000000004;
            body_on_[6] = upper_reverse_voltage_6 >= upper_body_threshold_6 + (body_on_[6] ? -hysteresis : hysteresis);
            body_on_[7] = lower_reverse_voltage_7 >= lower_body_threshold_7 + (body_on_[7] ? -hysteresis : hysteresis);
            if (body_on_[6] && body_on_[7])
                throw std::runtime_error("half bridge entered impossible simultaneous reverse conduction: PWM9/PWM10");
            if (body_on_[6]) {
                half_bridge_modes_[3] = HalfBridgeOperatingMode::upper_passive_rectification;
                topology_index += 4U;
            } else if (body_on_[7]) {
                half_bridge_modes_[3] = HalfBridgeOperatingMode::lower_passive_rectification;
                topology_index += 2U;
            } else {
                half_bridge_modes_[3] = HalfBridgeOperatingMode::blocked;
            }
        }
        topology_index *= 5U;
        if (inputs.PWM7 != 0U && inputs.PWM8 != 0U)
            throw std::runtime_error("half bridge has simultaneous upper/lower channel commands: PWM7/PWM8");
        if (inputs.PWM7 != 0U) {
            body_on_[8] = body_on_[9] = false;
            half_bridge_modes_[4] = HalfBridgeOperatingMode::upper_channel;
            topology_index += 3U;
        } else if (inputs.PWM8 != 0U) {
            body_on_[8] = body_on_[9] = false;
            half_bridge_modes_[4] = HalfBridgeOperatingMode::lower_channel;
            topology_index += 1U;
        } else {
            const double upper_reverse_voltage_8 = signals_(28) - signals_(27);
            const double lower_reverse_voltage_9 = signals_(30) - signals_(29);
            constexpr double upper_body_threshold_8 = 0.80000000000000004;
            constexpr double lower_body_threshold_9 = 0.80000000000000004;
            body_on_[8] = upper_reverse_voltage_8 >= upper_body_threshold_8 + (body_on_[8] ? -hysteresis : hysteresis);
            body_on_[9] = lower_reverse_voltage_9 >= lower_body_threshold_9 + (body_on_[9] ? -hysteresis : hysteresis);
            if (body_on_[8] && body_on_[9])
                throw std::runtime_error("half bridge entered impossible simultaneous reverse conduction: PWM7/PWM8");
            if (body_on_[8]) {
                half_bridge_modes_[4] = HalfBridgeOperatingMode::upper_passive_rectification;
                topology_index += 4U;
            } else if (body_on_[9]) {
                half_bridge_modes_[4] = HalfBridgeOperatingMode::lower_passive_rectification;
                topology_index += 2U;
            } else {
                half_bridge_modes_[4] = HalfBridgeOperatingMode::blocked;
            }
        }
        topology_index *= 5U;
        if (inputs.PWM11 != 0U && inputs.PWM12 != 0U)
            throw std::runtime_error("half bridge has simultaneous upper/lower channel commands: PWM11/PWM12");
        if (inputs.PWM11 != 0U) {
            body_on_[10] = body_on_[11] = false;
            half_bridge_modes_[5] = HalfBridgeOperatingMode::upper_channel;
            topology_index += 3U;
        } else if (inputs.PWM12 != 0U) {
            body_on_[10] = body_on_[11] = false;
            half_bridge_modes_[5] = HalfBridgeOperatingMode::lower_channel;
            topology_index += 1U;
        } else {
            const double upper_reverse_voltage_10 = signals_(32) - signals_(31);
            const double lower_reverse_voltage_11 = signals_(34) - signals_(33);
            constexpr double upper_body_threshold_10 = 0.80000000000000004;
            constexpr double lower_body_threshold_11 = 0.80000000000000004;
            body_on_[10] = upper_reverse_voltage_10 >= upper_body_threshold_10 + (body_on_[10] ? -hysteresis : hysteresis);
            body_on_[11] = lower_reverse_voltage_11 >= lower_body_threshold_11 + (body_on_[11] ? -hysteresis : hysteresis);
            if (body_on_[10] && body_on_[11])
                throw std::runtime_error("half bridge entered impossible simultaneous reverse conduction: PWM11/PWM12");
            if (body_on_[10]) {
                half_bridge_modes_[5] = HalfBridgeOperatingMode::upper_passive_rectification;
                topology_index += 4U;
            } else if (body_on_[11]) {
                half_bridge_modes_[5] = HalfBridgeOperatingMode::lower_passive_rectification;
                topology_index += 2U;
            } else {
                half_bridge_modes_[5] = HalfBridgeOperatingMode::blocked;
            }
        }
        return topology_index;
    }

    const Outputs& step(const Inputs& inputs, bool use_short_step) {
        last_topology_index_ = select_topology(inputs);
        const auto stored_topology_index = resolve_stored_topology(last_topology_index_);
        last_calculation_state_index_ = topology_to_calculation_state()[stored_topology_index];
        const auto& calculation_state = calculation_states()[last_calculation_state_index_];
        InputVector input_vector;
        input_vector << inputs.VS4, inputs.VS3, inputs.VS2;
        if (use_short_step) {{
            state_ = state_matrices()[calculation_state.short_A] * state_
                + input_matrices()[calculation_state.short_B] * input_vector
                + state_vectors()[calculation_state.short_bias];
        }} else {{
            state_ = state_matrices()[calculation_state.normal_A] * state_
                + input_matrices()[calculation_state.normal_B] * input_vector
                + state_vectors()[calculation_state.normal_bias];
        }}
        signals_ = signal_matrices()[calculation_state.C] * state_
            + signal_input_matrices()[calculation_state.D] * input_vector
            + signal_vectors()[calculation_state.output_bias];
        output.UBUS = signals_(0);
        output.n_20 = signals_(1);
        output.LGRID_A = signals_(2);
        output.LGRID_B = signals_(3);
        output.LGRID_C = signals_(4);
        output.VAM3 = signals_(5);
        output.VAM2 = signals_(6);
        output.VAM1 = signals_(7);
        output.n_32 = signals_(8);
        output.n_31 = signals_(9);
        output.n_30 = signals_(10);
        return output;
    }

    std::shared_ptr<const ArchiveData> archive_;
    StateVector state_{StateVector::Zero()};
    SignalVector signals_{SignalVector::Zero()};
    std::array<bool, 12> body_on_{};
    HalfBridgeOperatingModes half_bridge_modes_{};
    std::size_t last_topology_index_{0};
    std::size_t last_calculation_state_index_{0};
};
