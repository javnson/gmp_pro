#pragma once

// Generated by GMP mna_solver/cpp_codegen.py from PMSM.CIR.
// Source SHA-256: ec6ca113ace0bf79d6e1c865dc646e5c9e246b99540361f586292679199d8d23
// Matrix equivalence tolerance: 9.9999999999999998e-13
// Matrix backend: eigen
// Selection states: 729; stored reachable states: 729; unique calculation states: 729.
// Do not hand-edit; regenerate from the circuit-data JSON file.

#include <Eigen/Dense>

#include <array>
#include <cstddef>
#include <cstdint>
#include <stdexcept>
#include <string>
#include <string_view>
#include <vector>
#include <cstring>
#include <filesystem>
#include <fstream>
#include <limits>
#include <memory>
#include <vector>

class PmsmCircuit {
public:
    static constexpr std::size_t state_count = 23;
    static constexpr std::size_t signal_count = 25;
    static constexpr std::size_t analog_input_count = 7;
    static constexpr std::size_t pwm_input_count = 6;
    static constexpr std::size_t topology_count = 729;
    static constexpr std::size_t stored_topology_count = 729;
    static constexpr std::size_t calculation_state_count = 729;
    static constexpr const char* matrix_backend = "eigen";
    static constexpr const char* matrix_storage = "archive";
    static constexpr const char* archive_filename = "pmsmcircuit.archive";
    static constexpr std::size_t state_matrix_count = 1458;
    static constexpr std::size_t input_matrix_count = 1458;
    static constexpr std::size_t state_vector_count = 1331;
    static constexpr std::size_t signal_matrix_count = 1;
    static constexpr std::size_t signal_input_matrix_count = 1;
    static constexpr std::size_t signal_vector_count = 1;
    static constexpr double normal_step_s = 1.0000000000000001e-07;
    static constexpr double short_step_s = 1.0000000000000001e-09;
    static constexpr double matrix_tolerance = 9.9999999999999998e-13;
    static constexpr const char* discretization_method = "backward_euler";


    struct Inputs {
        std::uint32_t PWM1{0U};
        std::uint32_t PWM2{0U};
        std::uint32_t PWM3{0U};
        std::uint32_t PWM4{0U};
        std::uint32_t PWM5{0U};
        std::uint32_t PWM6{0U};
        double VS4{1.6499999999999999};
        double VS3{1.6499999999999999};
        double VS2{1.6499999999999999};
        double IPMSM1_C{0.0};
        double IPMSM1_B{0.0};
        double IPMSM1_A{0.0};
        double VS1{5.0};
    };

    struct Outputs {
        double VADC_VDC{0.0};
        double VADC_VC{0.0};
        double VADC_VB{0.0};
        double VADC_VA{0.0};
        double VADC_IC{0.0};
        double VADC_IB{0.0};
        double VADC_IA{0.0};
        double VAM3{0.0};
        double VAM2{0.0};
        double VAM1{0.0};
        double VPMSM1_A{0.0};
        double VPMSM1_B{0.0};
        double VPMSM1_C{0.0};

        double operator[](std::string_view name) const {
            if (name == "V(VADC_VDC)" || name == "VADC_VDC") return VADC_VDC;
            if (name == "V(VADC_VC)" || name == "VADC_VC") return VADC_VC;
            if (name == "V(VADC_VB)" || name == "VADC_VB") return VADC_VB;
            if (name == "V(VADC_VA)" || name == "VADC_VA") return VADC_VA;
            if (name == "V(VADC_IC)" || name == "VADC_IC") return VADC_IC;
            if (name == "V(VADC_IB)" || name == "VADC_IB") return VADC_IB;
            if (name == "V(VADC_IA)" || name == "VADC_IA") return VADC_IA;
            if (name == "I(VAM3)" || name == "VAM3") return VAM3;
            if (name == "I(VAM2)" || name == "VAM2") return VAM2;
            if (name == "I(VAM1)" || name == "VAM1") return VAM1;
            if (name == "VPMSM1_A" || name == "VPMSM1_A") return VPMSM1_A;
            if (name == "VPMSM1_B" || name == "VPMSM1_B") return VPMSM1_B;
            if (name == "VPMSM1_C" || name == "VPMSM1_C") return VPMSM1_C;
            throw std::out_of_range("unknown circuit output: " + std::string(name));
        }
    };

    Outputs output{};

    explicit PmsmCircuit(
        const std::filesystem::path& archive_path = std::filesystem::path(archive_filename))
        : archive_(load_archive(archive_path)) { reset(); }

    void reset() {
        state_.setZero();
        signals_.setZero();
        body_on_.fill(false);
        last_topology_index_ = 0;
        last_calculation_state_index_ = topology_to_calculation_state()[0];
        output = Outputs{};
    }

    const Outputs& step_short(const Inputs& inputs) { return step(inputs, true); }
    const Outputs& step_normal(const Inputs& inputs) { return step(inputs, false); }

    const Outputs& step_short(std::uint32_t PWM1, std::uint32_t PWM2, std::uint32_t PWM3, std::uint32_t PWM4, std::uint32_t PWM5, std::uint32_t PWM6, double VS4, double VS3, double VS2, double IPMSM1_C, double IPMSM1_B, double IPMSM1_A, double VS1) {
        return step_short(Inputs{PWM1, PWM2, PWM3, PWM4, PWM5, PWM6, VS4, VS3, VS2, IPMSM1_C, IPMSM1_B, IPMSM1_A, VS1});
    }

    const Outputs& step_normal(std::uint32_t PWM1, std::uint32_t PWM2, std::uint32_t PWM3, std::uint32_t PWM4, std::uint32_t PWM5, std::uint32_t PWM6, double VS4, double VS3, double VS2, double IPMSM1_C, double IPMSM1_B, double IPMSM1_A, double VS1) {
        return step_normal(Inputs{PWM1, PWM2, PWM3, PWM4, PWM5, PWM6, VS4, VS3, VS2, IPMSM1_C, IPMSM1_B, IPMSM1_A, VS1});
    }

    const Outputs& run(std::uint32_t PWM1, std::uint32_t PWM2, std::uint32_t PWM3, std::uint32_t PWM4, std::uint32_t PWM5, std::uint32_t PWM6, double VS4, double VS3, double VS2, double IPMSM1_C, double IPMSM1_B, double IPMSM1_A, double VS1) {
        return step_normal(PWM1, PWM2, PWM3, PWM4, PWM5, PWM6, VS4, VS3, VS2, IPMSM1_C, IPMSM1_B, IPMSM1_A, VS1);
    }

    const Outputs& operator()(std::uint32_t PWM1, std::uint32_t PWM2, std::uint32_t PWM3, std::uint32_t PWM4, std::uint32_t PWM5, std::uint32_t PWM6, double VS4, double VS3, double VS2, double IPMSM1_C, double IPMSM1_B, double IPMSM1_A, double VS1) {
        return run(PWM1, PWM2, PWM3, PWM4, PWM5, PWM6, VS4, VS3, VS2, IPMSM1_C, IPMSM1_B, IPMSM1_A, VS1);
    }

    double operator[](std::string_view name) const { return output[name]; }
    const auto& state() const noexcept { return state_; }
    std::size_t last_topology_index() const noexcept { return last_topology_index_; }
    std::size_t last_calculation_state_index() const noexcept { return last_calculation_state_index_; }


private:
    using StateMatrix = Eigen::Matrix<double, 23, 23>;
    using InputMatrix = Eigen::Matrix<double, 23, 7>;
    using StateVector = Eigen::Matrix<double, 23, 1>;
    using SignalMatrix = Eigen::Matrix<double, 25, 23>;
    using SignalInputMatrix = Eigen::Matrix<double, 25, 7>;
    using SignalVector = Eigen::Matrix<double, 25, 1>;
    using InputVector = Eigen::Matrix<double, 7, 1>;

    struct CalculationState {
        std::size_t normal_A;
        std::size_t normal_B;
        std::size_t normal_bias;
        std::size_t short_A;
        std::size_t short_B;
        std::size_t short_bias;
        std::size_t C;
        std::size_t D;
        std::size_t output_bias;
    };

    static constexpr std::size_t invalid_topology_index = static_cast<std::size_t>(-1);

    template <typename Matrix>
    using MatrixPool = std::vector<Matrix, Eigen::aligned_allocator<Matrix>>;

    struct ArchiveData {
        MatrixPool<StateMatrix> state_matrices;
        MatrixPool<InputMatrix> input_matrices;
        MatrixPool<StateVector> state_vectors;
        MatrixPool<SignalMatrix> signal_matrices;
        MatrixPool<SignalInputMatrix> signal_input_matrices;
        MatrixPool<SignalVector> signal_vectors;
        std::vector<CalculationState> calculation_states;
        std::vector<std::size_t> topology_to_calculation_state;
    };

    static std::uint32_t read_u32(const std::vector<std::uint8_t>& bytes,
                                  std::size_t& cursor) {
        require_bytes(bytes, cursor, sizeof(std::uint32_t));
        std::uint32_t value = 0U;
        std::memcpy(&value, bytes.data() + cursor, sizeof(value));
        cursor += sizeof(value);
        return value;
    }

    static std::uint64_t read_u64(const std::vector<std::uint8_t>& bytes,
                                  std::size_t& cursor) {
        require_bytes(bytes, cursor, sizeof(std::uint64_t));
        std::uint64_t value = 0U;
        std::memcpy(&value, bytes.data() + cursor, sizeof(value));
        cursor += sizeof(value);
        return value;
    }

    static double read_f64(const std::vector<std::uint8_t>& bytes,
                           std::size_t& cursor) {
        require_bytes(bytes, cursor, sizeof(double));
        double value = 0.0;
        std::memcpy(&value, bytes.data() + cursor, sizeof(value));
        cursor += sizeof(value);
        return value;
    }

    static void require_bytes(const std::vector<std::uint8_t>& bytes,
                              std::size_t cursor, std::size_t count) {
        if (cursor > bytes.size() || count > bytes.size() - cursor)
            throw std::runtime_error("truncated matrix archive");
    }

    static std::uint64_t fnv1a64(const std::uint8_t* data, std::size_t size) noexcept {
        std::uint64_t value = UINT64_C(14695981039346656037);
        for (std::size_t index = 0U; index < size; ++index) {
            value ^= data[index];
            value *= UINT64_C(1099511628211);
        }
        return value;
    }

    template <typename Matrix>
    static void read_matrix_pool(MatrixPool<Matrix>& pool, std::size_t count,
                                 const std::vector<std::uint8_t>& bytes,
                                 std::size_t& cursor) {
        constexpr std::size_t coefficient_count =
            static_cast<std::size_t>(Matrix::SizeAtCompileTime);
        constexpr std::size_t matrix_bytes = coefficient_count * sizeof(double);
        pool.resize(count);
        if constexpr (matrix_bytes == 0U)
            return;
        if (count > (std::numeric_limits<std::size_t>::max)() / matrix_bytes)
            throw std::runtime_error("matrix archive pool size overflow");
        require_bytes(bytes, cursor, count * matrix_bytes);
        for (auto& matrix : pool) {
            std::memcpy(matrix.data(), bytes.data() + cursor, matrix_bytes);
            cursor += matrix_bytes;
        }
    }

    static std::shared_ptr<const ArchiveData> load_archive(
        const std::filesystem::path& path) {
        const std::uint16_t endian_probe = 1U;
        if (*reinterpret_cast<const std::uint8_t*>(&endian_probe) != 1U)
            throw std::runtime_error("matrix archives currently require a little-endian host");

        std::ifstream input(path, std::ios::binary | std::ios::ate);
        if (!input)
            throw std::runtime_error("cannot open matrix archive: " + path.string());
        const std::streamoff end = input.tellg();
        if (end < 0 || static_cast<std::uintmax_t>(end) >
                           (std::numeric_limits<std::size_t>::max)())
            throw std::runtime_error("invalid matrix archive size: " + path.string());
        std::vector<std::uint8_t> bytes(static_cast<std::size_t>(end));
        input.seekg(0, std::ios::beg);
        if (!bytes.empty() &&
            !input.read(reinterpret_cast<char*>(bytes.data()),
                        static_cast<std::streamsize>(bytes.size())))
            throw std::runtime_error("cannot read matrix archive: " + path.string());

        constexpr std::array<std::uint8_t, 8U> expected_magic{{
            0x47U, 0x4dU, 0x50U, 0x4dU, 0x4eU, 0x41U, 0x31U, 0x00U
        }};
        constexpr std::array<std::uint8_t, 32U> expected_source_hash{{
            0xdeU, 0x04U, 0x4cU, 0xcaU, 0xfdU, 0xadU, 0x42U, 0xdbU, 0xe7U, 0x72U, 0x74U, 0xb0U, 0x49U, 0xb9U, 0x52U, 0xa4U, 0xbfU, 0x87U, 0x27U, 0x7fU, 0x42U, 0xfeU, 0x91U, 0x84U, 0x55U, 0x5dU, 0x80U, 0xa4U, 0x56U, 0x6eU, 0xd7U, 0xa7U
        }};
        require_bytes(bytes, 0U, expected_magic.size());
        if (std::memcmp(bytes.data(), expected_magic.data(), expected_magic.size()) != 0)
            throw std::runtime_error("invalid matrix archive magic: " + path.string());

        std::size_t cursor = expected_magic.size();
        const auto expect_u32 = [&](std::uint32_t expected, const char* field) {
            if (read_u32(bytes, cursor) != expected)
                throw std::runtime_error(std::string("matrix archive mismatch: ") + field);
        };
        expect_u32(1U, "version");
        expect_u32(140U, "header size");
        expect_u32(0x01020304U, "endianness");
        expect_u32(8U, "scalar size");
        expect_u32(static_cast<std::uint32_t>(state_count), "state count");
        expect_u32(static_cast<std::uint32_t>(analog_input_count), "input count");
        expect_u32(static_cast<std::uint32_t>(signal_count), "signal count");
        expect_u32(static_cast<std::uint32_t>(stored_topology_count), "topology count");
        expect_u32(static_cast<std::uint32_t>(calculation_state_count),
                   "calculation-state count");
        expect_u32(static_cast<std::uint32_t>(state_matrix_count),
                   "state-matrix count");
        expect_u32(static_cast<std::uint32_t>(input_matrix_count),
                   "input-matrix count");
        expect_u32(static_cast<std::uint32_t>(state_vector_count),
                   "state-vector count");
        expect_u32(static_cast<std::uint32_t>(signal_matrix_count),
                   "signal-matrix count");
        expect_u32(static_cast<std::uint32_t>(signal_input_matrix_count),
                   "signal-input-matrix count");
        expect_u32(static_cast<std::uint32_t>(signal_vector_count),
                   "signal-vector count");
        if (read_f64(bytes, cursor) != normal_step_s ||
            read_f64(bytes, cursor) != short_step_s ||
            read_f64(bytes, cursor) != matrix_tolerance)
            throw std::runtime_error("matrix archive solver metadata mismatch");
        require_bytes(bytes, cursor, expected_source_hash.size());
        if (std::memcmp(bytes.data() + cursor, expected_source_hash.data(),
                        expected_source_hash.size()) != 0)
            throw std::runtime_error("matrix archive source hash mismatch");
        cursor += expected_source_hash.size();
        const std::uint64_t payload_size = read_u64(bytes, cursor);
        const std::uint64_t payload_hash = read_u64(bytes, cursor);
        if (cursor != 140U ||
            payload_size != static_cast<std::uint64_t>(bytes.size() - cursor))
            throw std::runtime_error("matrix archive payload size mismatch");
        if (fnv1a64(bytes.data() + cursor, static_cast<std::size_t>(payload_size)) !=
            payload_hash)
            throw std::runtime_error("matrix archive payload checksum mismatch");

        auto result = std::make_shared<ArchiveData>();
        result->topology_to_calculation_state.resize(stored_topology_count);
        for (auto& value : result->topology_to_calculation_state) {
            value = read_u32(bytes, cursor);
            if (value >= calculation_state_count)
                throw std::runtime_error("matrix archive topology index is out of range");
        }
        result->calculation_states.resize(calculation_state_count);
        for (auto& state : result->calculation_states) {
            state.normal_A = read_u32(bytes, cursor);
            state.normal_B = read_u32(bytes, cursor);
            state.normal_bias = read_u32(bytes, cursor);
            state.short_A = read_u32(bytes, cursor);
            state.short_B = read_u32(bytes, cursor);
            state.short_bias = read_u32(bytes, cursor);
            state.C = read_u32(bytes, cursor);
            state.D = read_u32(bytes, cursor);
            state.output_bias = read_u32(bytes, cursor);
            if (state.normal_A >= state_matrix_count ||
                state.short_A >= state_matrix_count ||
                state.normal_B >= input_matrix_count ||
                state.short_B >= input_matrix_count ||
                state.normal_bias >= state_vector_count ||
                state.short_bias >= state_vector_count ||
                state.C >= signal_matrix_count ||
                state.D >= signal_input_matrix_count ||
                state.output_bias >= signal_vector_count)
                throw std::runtime_error("matrix archive calculation-state index is out of range");
        }
        read_matrix_pool(result->state_matrices, state_matrix_count, bytes, cursor);
        read_matrix_pool(result->input_matrices, input_matrix_count, bytes, cursor);
        read_matrix_pool(result->state_vectors, state_vector_count, bytes, cursor);
        read_matrix_pool(result->signal_matrices, signal_matrix_count, bytes, cursor);
        read_matrix_pool(result->signal_input_matrices, signal_input_matrix_count,
                         bytes, cursor);
        read_matrix_pool(result->signal_vectors, signal_vector_count, bytes, cursor);
        if (cursor != bytes.size())
            throw std::runtime_error("matrix archive contains trailing data");
        return result;
    }

    const MatrixPool<StateMatrix>& state_matrices() const noexcept {
        return archive_->state_matrices;
    }
    const MatrixPool<InputMatrix>& input_matrices() const noexcept {
        return archive_->input_matrices;
    }
    const MatrixPool<StateVector>& state_vectors() const noexcept {
        return archive_->state_vectors;
    }
    const MatrixPool<SignalMatrix>& signal_matrices() const noexcept {
        return archive_->signal_matrices;
    }
    const MatrixPool<SignalInputMatrix>& signal_input_matrices() const noexcept {
        return archive_->signal_input_matrices;
    }
    const MatrixPool<SignalVector>& signal_vectors() const noexcept {
        return archive_->signal_vectors;
    }
    const std::vector<CalculationState>& calculation_states() const noexcept {
        return archive_->calculation_states;
    }
    const std::vector<std::size_t>& topology_to_calculation_state() const noexcept {
        return archive_->topology_to_calculation_state;
    }

    static constexpr std::size_t resolve_stored_topology(
        std::size_t selection_index) noexcept {
        return selection_index;
    }

    std::size_t select_topology(const Inputs& inputs) {
        constexpr double hysteresis = 9.9999999999999995e-07;
        std::size_t topology_index = 0U;
        topology_index *= 3U;
        if (inputs.PWM3 != 0U) {
            body_on_[0] = false;
            topology_index += 1U;
        } else {
            const double reverse_voltage_0 = signals_(14) - signals_(13);
            constexpr double body_threshold_0 = 0.80000000000000004;
            body_on_[0] = reverse_voltage_0 >= body_threshold_0 + (body_on_[0] ? -hysteresis : hysteresis);
            topology_index += body_on_[0] ? 2U : 0U;
        }
        topology_index *= 3U;
        if (inputs.PWM4 != 0U) {
            body_on_[1] = false;
            topology_index += 1U;
        } else {
            const double reverse_voltage_1 = signals_(16) - signals_(15);
            constexpr double body_threshold_1 = 0.80000000000000004;
            body_on_[1] = reverse_voltage_1 >= body_threshold_1 + (body_on_[1] ? -hysteresis : hysteresis);
            topology_index += body_on_[1] ? 2U : 0U;
        }
        topology_index *= 3U;
        if (inputs.PWM1 != 0U) {
            body_on_[2] = false;
            topology_index += 1U;
        } else {
            const double reverse_voltage_2 = signals_(18) - signals_(17);
            constexpr double body_threshold_2 = 0.80000000000000004;
            body_on_[2] = reverse_voltage_2 >= body_threshold_2 + (body_on_[2] ? -hysteresis : hysteresis);
            topology_index += body_on_[2] ? 2U : 0U;
        }
        topology_index *= 3U;
        if (inputs.PWM2 != 0U) {
            body_on_[3] = false;
            topology_index += 1U;
        } else {
            const double reverse_voltage_3 = signals_(20) - signals_(19);
            constexpr double body_threshold_3 = 0.80000000000000004;
            body_on_[3] = reverse_voltage_3 >= body_threshold_3 + (body_on_[3] ? -hysteresis : hysteresis);
            topology_index += body_on_[3] ? 2U : 0U;
        }
        topology_index *= 3U;
        if (inputs.PWM5 != 0U) {
            body_on_[4] = false;
            topology_index += 1U;
        } else {
            const double reverse_voltage_4 = signals_(22) - signals_(21);
            constexpr double body_threshold_4 = 0.80000000000000004;
            body_on_[4] = reverse_voltage_4 >= body_threshold_4 + (body_on_[4] ? -hysteresis : hysteresis);
            topology_index += body_on_[4] ? 2U : 0U;
        }
        topology_index *= 3U;
        if (inputs.PWM6 != 0U) {
            body_on_[5] = false;
            topology_index += 1U;
        } else {
            const double reverse_voltage_5 = signals_(24) - signals_(23);
            constexpr double body_threshold_5 = 0.80000000000000004;
            body_on_[5] = reverse_voltage_5 >= body_threshold_5 + (body_on_[5] ? -hysteresis : hysteresis);
            topology_index += body_on_[5] ? 2U : 0U;
        }
        return topology_index;
    }

    const Outputs& step(const Inputs& inputs, bool use_short_step) {
        last_topology_index_ = select_topology(inputs);
        const auto stored_topology_index = resolve_stored_topology(last_topology_index_);
        last_calculation_state_index_ = topology_to_calculation_state()[stored_topology_index];
        const auto& calculation_state = calculation_states()[last_calculation_state_index_];
        InputVector input_vector;
        input_vector << inputs.VS4, inputs.VS3, inputs.VS2, inputs.IPMSM1_C, inputs.IPMSM1_B, inputs.IPMSM1_A, inputs.VS1;
        if (use_short_step) {{
            state_ = state_matrices()[calculation_state.short_A] * state_
                + input_matrices()[calculation_state.short_B] * input_vector
                + state_vectors()[calculation_state.short_bias];
        }} else {{
            state_ = state_matrices()[calculation_state.normal_A] * state_
                + input_matrices()[calculation_state.normal_B] * input_vector
                + state_vectors()[calculation_state.normal_bias];
        }}
        signals_ = signal_matrices()[calculation_state.C] * state_
            + signal_input_matrices()[calculation_state.D] * input_vector
            + signal_vectors()[calculation_state.output_bias];
        output.VADC_VDC = signals_(0);
        output.VADC_VC = signals_(1);
        output.VADC_VB = signals_(2);
        output.VADC_VA = signals_(3);
        output.VADC_IC = signals_(4);
        output.VADC_IB = signals_(5);
        output.VADC_IA = signals_(6);
        output.VAM3 = signals_(7);
        output.VAM2 = signals_(8);
        output.VAM1 = signals_(9);
        output.VPMSM1_A = signals_(10);
        output.VPMSM1_B = signals_(11);
        output.VPMSM1_C = signals_(12);
        return output;
    }

    std::shared_ptr<const ArchiveData> archive_;
    StateVector state_{StateVector::Zero()};
    SignalVector signals_{SignalVector::Zero()};
    std::array<bool, 6> body_on_{};
    std::size_t last_topology_index_{0};
    std::size_t last_calculation_state_index_{0};
};
